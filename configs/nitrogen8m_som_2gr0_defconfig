## configs/nitrogen8mp_2gr0_defconfig
```kconfig
CONFIG_ARM=y
CONFIG_SPL_SYS_ICACHE_OFF=y
CONFIG_SPL_SYS_DCACHE_OFF=y
CONFIG_ARCH_IMX8M=y
CONFIG_SYS_TEXT_BASE=0x40200000
CONFIG_SPL_GPIO_SUPPORT=y
CONFIG_SPL_LIBCOMMON_SUPPORT=y
CONFIG_SPL_LIBGENERIC_SUPPORT=y
CONFIG_SYS_MALLOC_F_LEN=0x10000
CONFIG_NR_DRAM_BANKS=2
CONFIG_ENV_SIZE=0x2000
CONFIG_ENV_OFFSET=0xffffe000
CONFIG_DDR_RANK_BITS=0
CONFIG_SYS_I2C_MXC_I2C1=y
CONFIG_SYS_I2C_MXC_I2C2=y
CONFIG_SYS_I2C_MXC_I2C3=y
CONFIG_DM_GPIO=y
CONFIG_SPL_TEXT_BASE=0x920000
CONFIG_BOUNDARY_BOARD_IMX8M=y
CONFIG_TARGET_NITROGEN8MP=y
CONFIG_SPL_MMC_SUPPORT=y
CONFIG_SPL_SERIAL_SUPPORT=y
CONFIG_SPL_DRIVERS_MISC_SUPPORT=y
CONFIG_SPL=y
CONFIG_SPL_IMX_ROMAPI_LOADADDR=0x48000000
CONFIG_DEFAULT_DEVICE_TREE="imx8mp-nitrogen8mp"
CONFIG_DISTRO_DEFAULTS=y
CONFIG_FIT=y
CONFIG_FIT_EXTERNAL_OFFSET=0x3000
CONFIG_FIT_SIGNATURE=y
CONFIG_SPL_LOAD_FIT=y
CONFIG_OPTEE_FIRMWARE="tee.bin"
CONFIG_SPL_FIT_GENERATOR="arch/arm/mach-imx/mkimage_fit_atf.sh"
CONFIG_LEGACY_IMAGE_FORMAT=y
CONFIG_OF_BOARD_SETUP=y
CONFIG_OF_SYSTEM_SETUP=y
CONFIG_SYS_EXTRA_OPTIONS="IMX_CONFIG=arch/arm/mach-imx/imx8m/imximage-8mp-lpddr4.cfg,DDR_MB=2048,DEFCONFIG=\"nitrogen8mp_2gr0\""
CONFIG_SYS_CONSOLE_OVERWRITE_ROUTINE=y
CONFIG_DEFAULT_FDT_FILE="imx8mp-nitrogen8mp.dtb"
CONFIG_BOARD_LATE_INIT=y
CONFIG_ARCH_MISC_INIT=y
CONFIG_BOARD_EARLY_INIT_F=y
CONFIG_AVB_VERIFY=y
CONFIG_SPL_BOARD_INIT=y
CONFIG_SPL_BOOTROM_SUPPORT=y
CONFIG_SPL_SYS_MALLOC_SIMPLE=y
CONFIG_SPL_SEPARATE_BSS=y
CONFIG_SYS_MMCSD_RAW_MODE_U_BOOT_USE_SECTOR=y
CONFIG_SYS_MMCSD_RAW_MODE_U_BOOT_SECTOR=0x300
CONFIG_SPL_I2C_SUPPORT=y
CONFIG_SPL_POWER_SUPPORT=y
CONFIG_SPL_WATCHDOG_SUPPORT=y
# CONFIG_BOOTM_NETBSD is not set
CONFIG_CMD_ADTIMG=y
CONFIG_CMD_ABOOTIMG=y
# CONFIG_CMD_EXPORTENV is not set
# CONFIG_CMD_IMPORTENV is not set
CONFIG_CMD_ERASEENV=y
# CONFIG_CMD_CRC32 is not set
CONFIG_CMD_MEMTEST=y
CONFIG_CMD_BCB=y
CONFIG_CMD_CLK=y
CONFIG_CMD_FUSE=y
CONFIG_CMD_GPIO=y
CONFIG_CMD_I2C=y
CONFIG_CMD_MMC=y
CONFIG_CMD_USB=y
CONFIG_CMD_USB_MASS_STORAGE=y
CONFIG_CMD_CACHE=y
CONFIG_CMD_REGULATOR=y
CONFIG_CMD_EXT4_WRITE=y
CONFIG_CMD_AVB=y
CONFIG_OF_CONTROL=y
CONFIG_SPL_OF_CONTROL=y
CONFIG_ENV_OVERWRITE=y
CONFIG_ENV_IS_IN_MMC=y
CONFIG_SYS_RELOC_GD_ENV_ADDR=y
CONFIG_SYS_MMC_ENV_DEV=2
CONFIG_SYS_MMC_ENV_PART=1
CONFIG_ENV_VARS_UBOOT_RUNTIME_CONFIG=y
CONFIG_SPL_DM=y
CONFIG_REGMAP=y
CONFIG_SYSCON=y
# CONFIG_SPL_BLK is not set
CONFIG_CLK_COMPOSITE_CCF=y
CONFIG_CLK_IMX8MP=y
CONFIG_IMX8M_LPDDR4=y
CONFIG_USB_FUNCTION_FASTBOOT=y
CONFIG_FASTBOOT_BUF_ADDR=0x42800000
CONFIG_FASTBOOT_BUF_SIZE=0x40000000
CONFIG_FASTBOOT_FLASH=y
CONFIG_FASTBOOT_FLASH_MMC_DEV=2
CONFIG_MXC_GPIO=y
CONFIG_DM_I2C=y
CONFIG_SYS_I2C_MXC=y
CONFIG_LED=y
CONFIG_LED_GPIO=y
CONFIG_DM_MMC=y
# CONFIG_SPL_DM_MMC is not set
CONFIG_SUPPORT_EMMC_BOOT=y
CONFIG_MMC_IO_VOLTAGE=y
CONFIG_MMC_UHS_SUPPORT=y
CONFIG_MMC_HS400_ES_SUPPORT=y
CONFIG_MMC_HS400_SUPPORT=y
CONFIG_FSL_USDHC=y
CONFIG_DM_SPI_FLASH=y
CONFIG_SF_DEFAULT_MODE=0
CONFIG_SF_DEFAULT_SPEED=40000000
CONFIG_SPI_FLASH_BAR=y
CONFIG_SPI_FLASH_STMICRO=y
CONFIG_PHY_ATHEROS=y
CONFIG_DM_ETH=y
CONFIG_PHY_GIGE=y
CONFIG_DWC_ETH_QOS=y
CONFIG_DWC_ETH_QOS_IMX=y
CONFIG_FEC_MXC=y
CONFIG_FEC_PHY_BITBANG=y
CONFIG_MII=y
CONFIG_PINCTRL=y
CONFIG_SPL_PINCTRL=y
CONFIG_PINCTRL_IMX8M=y
CONFIG_DM_REGULATOR=y
CONFIG_DM_REGULATOR_FIXED=y
CONFIG_DM_REGULATOR_GPIO=y
CONFIG_MXC_UART=y
CONFIG_SPI=y
CONFIG_DM_SPI=y
CONFIG_SYSRESET=y
CONFIG_SPL_SYSRESET=y
CONFIG_SYSRESET_PSCI=y
CONFIG_DM_THERMAL=y
CONFIG_USB=y
CONFIG_DM_USB=y
# CONFIG_SPL_DM_USB is not set
CONFIG_USB_XHCI_HCD=y
CONFIG_USB_XHCI_DWC3=y
CONFIG_USB_DWC3=y
CONFIG_USB_KEYBOARD=y
CONFIG_SYS_USB_EVENT_POLL_VIA_CONTROL_EP=y
CONFIG_USB_GADGET=y
CONFIG_USB_GADGET_MANUFACTURER="FSL"
CONFIG_USB_GADGET_VENDOR_NUM=0x0525
CONFIG_USB_GADGET_PRODUCT_NUM=0xa4a5
CONFIG_USB_ETHER=y
CONFIG_USB_ETH_CDC=y
CONFIG_USBNET_DEVADDR="00:19:b8:00:00:02"
CONFIG_USBNET_HOST_ADDR="00:19:b8:00:00:01"
CONFIG_USB_HOST_ETHER=y
CONFIG_USB_ETHER_ASIX=y
CONFIG_USB_ETHER_MCS7830=y
CONFIG_USB_ETHER_SMSC95XX=y
CONFIG_DM_VIDEO=y
CONFIG_SYS_WHITE_ON_BLACK=y
CONFIG_IMX_WATCHDOG=y
CONFIG_LIBAVB=y
CONFIG_OF_LIBFDT_OVERLAY=y
```

## configs/nw2_defconfig
```kconfig
CONFIG_ARM=y
CONFIG_ARCH_MX6=y
CONFIG_TARGET_NW=y
CONFIG_SYS_EXTRA_OPTIONS="IMX_CONFIG=board/boundary/nw/nw.cfg,MX6Q,DDR_MB=1024,REV2,DEFCONFIG=\"nw2\""
# CONFIG_CMD_IMLS is not set
# CONFIG_CMD_FLASH is not set
CONFIG_CMD_GPIO=y
CONFIG_SPI_FLASH=y
CONFIG_SPI_FLASH_SPANSION=y
CONFIG_SPI_FLASH_SST=y
```

## configs/nw_defconfig
```kconfig
CONFIG_SYS_EXTRA_OPTIONS="IMX_CONFIG=board/boundary/nw/nw.cfg,MX6Q,DDR_MB=1024"
CONFIG_ARM=y
CONFIG_TARGET_NW=y
```

## configs/ocquad_defconfig
```kconfig
CONFIG_SYS_EXTRA_OPTIONS="IMX_CONFIG=board/boundary/oc/ocquad.cfg,MX6Q,DDR_MB=1024"
CONFIG_ARM=y
CONFIG_TARGET_OC=y
```

## configs/ocsolo1g_defconfig
```kconfig
CONFIG_ARM=y
CONFIG_ARCH_MX6=y
CONFIG_TARGET_OC=y
CONFIG_SYS_EXTRA_OPTIONS="IMX_CONFIG=board/boundary/oc/ocsolo1g.cfg,MX6S,DDR_MB=1024,DEFCONFIG=\"ocsolo1g\""
# CONFIG_CMD_IMLS is not set
# CONFIG_CMD_FLASH is not set
CONFIG_CMD_GPIO=y
CONFIG_SPI_FLASH=y
CONFIG_SPI_FLASH_SPANSION=y
CONFIG_SPI_FLASH_SST=y
```

## configs/ocsolo_defconfig
```kconfig
CONFIG_SYS_EXTRA_OPTIONS="IMX_CONFIG=board/boundary/oc/ocsolo.cfg,MX6S,DDR_MB=512,DEFCONFIG=\"ocsolo\""
CONFIG_ARM=y
CONFIG_TARGET_OC=y
```

## configs/per_defconfig
```kconfig
CONFIG_ARM=y
CONFIG_TARGET_PER=y
CONFIG_SYS_EXTRA_OPTIONS="IMX_CONFIG=board/boundary/per/per.cfg,MX6Q,DDR_MB=2048,DEFCONFIG=\"per\""
# CONFIG_CMD_IMLS is not set
# CONFIG_CMD_FLASH is not set
CONFIG_SPI_FLASH=y
```

## configs/rc_defconfig
```kconfig
CONFIG_ARM=y
CONFIG_ARCH_MX6=y
CONFIG_TARGET_RC=y
CONFIG_SYS_EXTRA_OPTIONS="IMX_CONFIG=board/boundary/rc/rc1g.cfg,MX6DL,DDR_MB=1024,DEFCONFIG=\"rc\""
# CONFIG_CMD_IMLS is not set
# CONFIG_CMD_FLASH is not set
CONFIG_CMD_GPIO=y
CONFIG_SPI_FLASH=y
CONFIG_SPI_FLASH_SPANSION=y
CONFIG_SPI_FLASH_SST=y
```

## configs/s_defconfig
```kconfig
CONFIG_ARM=y
CONFIG_TARGET_S=y
CONFIG_SYS_EXTRA_OPTIONS="IMX_CONFIG=board/boundary/nitrogen6x/nitrogen6q2g.cfg,MX6Q,DDR_MB=2048,DEFCONFIG=\"s\""
# CONFIG_CMD_IMLS is not set
# CONFIG_CMD_FLASH is not set
CONFIG_SPI_FLASH=y
```

## configs/snap_defconfig
```kconfig
CONFIG_ARM=y
CONFIG_ARCH_MX6=y
CONFIG_SYS_TEXT_BASE=0x17800000
CONFIG_NR_DRAM_BANKS=1
CONFIG_ENV_SIZE=0x2000
CONFIG_ENV_OFFSET=0xc0000
CONFIG_ENV_SECT_SIZE=0x2000
CONFIG_MX6Q=y
CONFIG_BOUNDARY_BOARD_IMX6=y
CONFIG_TARGET_SNAP=y
CONFIG_ENV_VARS_UBOOT_CONFIG=y
CONFIG_SYS_EXTRA_OPTIONS="IMX_CONFIG=board/boundary/snap/snap2g.cfg,DDR_MB=2048,DEFCONFIG=\"snap\""
CONFIG_BOOTDELAY=3
CONFIG_SYS_CONSOLE_OVERWRITE_ROUTINE=y
CONFIG_SUPPORT_RAW_INITRD=y
CONFIG_MISC_INIT_R=y
CONFIG_BOARD_EARLY_INIT_F=y
CONFIG_HUSH_PARSER=y
CONFIG_CMD_BOOTZ=y
CONFIG_CMD_MEMTEST=y
CONFIG_SYS_ALT_MEMTEST=y
CONFIG_SYS_MEMTEST_START=0x10000000
CONFIG_SYS_MEMTEST_END=0x10010000
CONFIG_CMD_DFU=y
CONFIG_CMD_GPIO=y
CONFIG_CMD_GPT=y
# CONFIG_RANDOM_UUID is not set
CONFIG_CMD_I2C=y
CONFIG_CMD_MMC=y
CONFIG_CMD_PART=y
CONFIG_CMD_SATA=y
CONFIG_CMD_SF=y
CONFIG_CMD_USB=y
CONFIG_CMD_USB_MASS_STORAGE=y
CONFIG_CMD_DHCP=y
CONFIG_CMD_MII=y
CONFIG_CMD_PING=y
CONFIG_CMD_CACHE=y
CONFIG_CMD_TIME=y
CONFIG_CMD_EXT2=y
CONFIG_CMD_EXT4=y
CONFIG_CMD_EXT4_WRITE=y
CONFIG_CMD_FAT=y
CONFIG_CMD_FS_GENERIC=y
CONFIG_PARTITION_TYPE_GUID=y
CONFIG_ENV_IS_IN_SPI_FLASH=y
CONFIG_ENV_VARS_UBOOT_RUNTIME_CONFIG=y
CONFIG_NETCONSOLE=y
CONFIG_DWC_AHSATA=y
CONFIG_DFU_SF=y
CONFIG_USB_FUNCTION_FASTBOOT=y
CONFIG_FASTBOOT_BUF_ADDR=0x12000000
CONFIG_FASTBOOT_BUF_SIZE=0x26000000
CONFIG_FASTBOOT_FLASH=y
CONFIG_FASTBOOT_FLASH_MMC_DEV=1
CONFIG_FSL_ESDHC_IMX=y
CONFIG_SPI_FLASH=y
CONFIG_SF_DEFAULT_MODE=0
CONFIG_SF_DEFAULT_SPEED=25000000
CONFIG_SPI_FLASH_GIGADEVICE=y
CONFIG_SPI_FLASH_SPANSION=y
CONFIG_SPI_FLASH_SST=y
CONFIG_PHYLIB=y
CONFIG_PHY_MICREL=y
CONFIG_PHY_MICREL_KSZ90X1=y
CONFIG_FEC_MXC=y
CONFIG_MII=y
CONFIG_MXC_UART=y
CONFIG_SPI=y
CONFIG_MXC_SPI=y
CONFIG_USB=y
CONFIG_USB_STORAGE=y
CONFIG_USB_KEYBOARD=y
CONFIG_SYS_USB_EVENT_POLL_VIA_CONTROL_EP=y
CONFIG_USB_GADGET=y
CONFIG_USB_GADGET_MANUFACTURER="Boundary"
CONFIG_USB_GADGET_VENDOR_NUM=0x3016
CONFIG_USB_GADGET_PRODUCT_NUM=0x0001
CONFIG_CI_UDC=y
CONFIG_USB_ETHER=y
CONFIG_USB_ETH_CDC=y
CONFIG_USB_HOST_ETHER=y
CONFIG_USB_ETHER_ASIX=y
CONFIG_USB_ETHER_MCS7830=y
CONFIG_USB_ETHER_SMSC95XX=y
CONFIG_OF_LIBFDT=y
```

## configs/ta_defconfig
```kconfig
CONFIG_ARM=y
CONFIG_ARCH_MX6=y
CONFIG_TARGET_TA=y
CONFIG_SYS_EXTRA_OPTIONS="IMX_CONFIG=board/boundary/ta/ta1g.cfg,MX6Q,DDR_MB=1024,DEFCONFIG=\"ta\""
# CONFIG_CMD_IMLS is not set
# CONFIG_CMD_FLASH is not set
CONFIG_CMD_GPIO=y
CONFIG_SPI_FLASH=y
CONFIG_SPI_FLASH_SPANSION=y
CONFIG_SPI_FLASH_SST=y
```

## configs/vp_defconfig
```kconfig
CONFIG_ARM=y
CONFIG_TARGET_VP=y
CONFIG_SYS_EXTRA_OPTIONS="IMX_CONFIG=board/boundary/vp/vp2g.cfg,MX6Q,DDR_MB=2048,DEFCONFIG=\"vp\""
# CONFIG_CMD_IMLS is not set
# CONFIG_CMD_FLASH is not set
CONFIG_SPI_FLASH=y
```

## configs/ys_512m_defconfig
```kconfig
CONFIG_ARM=y
CONFIG_ARCH_MX6=y
CONFIG_TARGET_YS=y
CONFIG_SYS_EXTRA_OPTIONS="IMX_CONFIG=board/boundary/ys/ys_512m.cfg,MX6SX,DEFCONFIG=\"ys_512m\""
CONFIG_IMX_BOOTAUX=y
# CONFIG_CMD_IMLS is not set
# CONFIG_CMD_FLASH is not set
CONFIG_CMD_GPIO=y
CONFIG_SPI_FLASH=y
CONFIG_SPI_FLASH_SPANSION=y
CONFIG_SPI_FLASH_SST=y
CONFIG_SPI_FLASH_WINBOND=y
CONFIG_SPI_FLASH_MACRONIX=y
```

## drivers/clk/mediatek/Kconfig
```kconfig
config CLK_MT8188
	bool "Enable clock support for mediatek mt8188"
	depends on ARCH_MEDIATEK
	select CLK
	select CLK_CCF
	select CLK_COMPOSITE_CCF
```

## drivers/mux/Kconfig
```kconfig
#
# MUX subsystem configuration
#

menu "mux support"

config DM_MUX
	bool "Enable Driver Model for mux drivers"
	depends on DM
	help
	  Enable driver model for MUX.

config MUX_MMIO
	tristate "MMIO/Regmap register bitfield-controlled Multiplexer"
	depends on OF_CONTROL
	select DM_MUX
	help
	  MMIO/Regmap register bitfield-controlled Multiplexer controller.

	  The driver builds multiplexer controllers for bitfields in either
	  a syscon register or a driver regmap register. For N bit wide
	  bitfields, there will be 2^N possible multiplexer states.

endmenu
```

## drivers/soc/mediatek/Kconfig
```kconfig
menuconfig SOC_MEDIATEK
	bool "Mediatek SOC drivers support"

if SOC_MEDIATEK
config MT2701
	bool "Enable wrap for mt2701"

config MT6323
	bool "Enable pmic mt6323"

config MT6351
	bool "Enable pmic mt6351"

config MT6357
	bool "Enable pmic mt6357"

config MT6358
	bool "Enable pmic mt6358"

config MT6359
	bool "Enable pmic mt6359"
	default y if TARGET_MT8188

config MT6380
	bool "Enable pmic mt6380"

config MT6397
	bool "Enable pmic mt6397"

config MT6765
	bool "Enable wrap for mt6765"

config MT6779
	bool "Enable wrap for mt6779"

config MT6797
	bool "Enable wrap for mt6797"

config MT6873
	bool "Enable wrap for mt6873"

config MT7622
	bool "Enable wrap for mt7622"

config MT8135
	bool "Enable wrap for mt8135"

config MT8173
	bool "Enable wrap for mt8173"

config MT8183
	bool "Enable wrap for mt8183"

config MT8188
	bool "Enable wrap for mt8188"
	default y if TARGET_MT8188

config MT8195
	bool "Enable wrap for mt8195"

config MT8365
	bool "Enable wrap for mt8365"

config MT8516
	bool "Enable wrap for mt8516"

endif # SOC_MEDIATEK
```

## drivers/video/imx/Kconfig
```kconfig
config VIDEO_IPUV3
	bool "i.MX IPUv3 Core video support"
	depends on (VIDEO || DM_VIDEO) && (MX5 || MX6)
	help
	  This enables framebuffer driver for i.MX processors working
	  on the IPUv3(Image Processing Unit) internal graphic processor.

config VIDEO_IMXDPUV1
	bool "i.MX DPU V1 display support"
	default n
	depends on IMX8 && DM_VIDEO
	select VIDEO_LINK
	help
	  Support for IMXDPU V1 display controller for i.MX8 processors.

config VIDEO_IMX8_LVDS
	bool "i.MX8 LDVS bridge support"
	default n
	depends on IMX8 && DM_VIDEO
	select DISPLAY
	select VIDEO_LINK
	help
	  Support for i.MX8 LDVS bridge controller for i.MX8 processors.

config VIDEO_IMX_HDP_LOAD
	bool "i.MX8 HDMI/DP firmware loading"
	default n
	depends on IMX8QM
	help
	  Support for HDMI/DP firmware loading for i.MX8QM processors. The
	  firmware is copied from system memory to the HDMI/DP IRAM and
	  DRAM memory.

config VIDEO_IMX8M_DCSS
	bool "i.MX8M DCSS controller"
	default n
	depends on IMX8M && DM_VIDEO
	select VIDEO_LINK
	help
	  Support for DCSS on i.MX8MQ processors.

config VIDEO_IMX8M_HDMI
	bool "i.MX8M HDMI Splash screen"
	default n
	depends on IMX8M && DM_VIDEO
	select DISPLAY
	select VIDEO_LINK
	help
	  Support for HDMI on i.MX8MQ processors.

config VIDEO_SEC_MIPI_DSI
	bool
	select VIDEO_MIPI_DSI
	select CLK_GENERIC
	help
	  Enables the common driver code for the Samsung
	  MIPI DSI block found in SoCs from various vendors.
	  As this does not provide any functionality by itself (but
	  rather requires a SoC-specific glue driver to call it), it
	  can not be enabled from the configuration menu.

config VIDEO_IMX_SEC_DSI
	bool "Enable IMX SEC DSI video support"
	select VIDEO_BRIDGE
	select VIDEO_SEC_MIPI_DSI
	select VIDEO_LINK
	help
	  This option enables support DSI internal bridge which can be used on
	  devices which have DSI devices connected.

config VIDEO_IMX_LCDIFV3
	bool "i.MX LCDIFv3 support"
	depends on DM_VIDEO && IMX8MP
	select VIDEO_LINK
	help
	  Support for i.MX8MP LCDIFv3 controller.

config VIDEO_DW_HDMI
	bool "DW HDMI library"

config VIDEO_DW_HDMI_I2C
	bool "DW HDMI i2c ddc device"

config IMX8MP_HDMI_PAVI
	bool

config VIDEO_IMX8MP_HDMI
	bool "i.MX8MP HDMI support"
	depends on DM_VIDEO && IMX8MP
	select DRM_SCDC_HELPER
	select VIDEO_DW_HDMI
	select VIDEO_DW_HDMI_I2C
	select PHY_SAMSUNG_HDMI
	select IMX8MP_HDMI_PAVI
	select RESET_IMX_HDMIMIX
	select DISPLAY
	select DISPLAY_DETECT
	help
	  Support for i.MX8MP HDMI controller.

config VIDEO_IMX8MP_LVDS
	bool "i.MX8MP LVDS support"
	depends on DM_VIDEO && IMX8MP
	select PHY_IMX8MP_LVDS
	select VIDEO_BRIDGE
	help
	  Support for i.MX8MP LVDS controller.

config VIDEO_IMX_NW_DSI
	bool "Enable IMX Northwest DSI video support"
	select VIDEO_BRIDGE
	select VIDEO_LINK
	help
	  This option enables support DSI internal bridge which can be used on
	  devices which have DSI devices connected.

config VIDEO_NWL_MIPI_DSI
	bool "Enable IMX8 Northwest DSI video support"
	select VIDEO_MIPI_DSI
	select VIDEO_IMX_NW_DSI
	select CLK_GENERIC
	select PHY_MIXEL_MIPI_DPHY
	help
	  This option enables support DSI internal bridge which can be used on
	  devices which have DSI devices connected.

config VIDEO_IMX_DCNANO
	bool "i.MX DCNANO LCDIF support"
	depends on DM_VIDEO && IMX8ULP
	select VIDEO_LINK
	help
	  Support for i.MX8ULP DCNANO LCD controller.
```

## drivers/video/mediatek/Kconfig
```kconfig
# SPDX-License-Identifier: GPL-2.0+
#
# Copyright (C) 2022 BayLibre, SAS
#
# Author: Julien Masson <jmasson@baylibre.com>

config VIDEO_MEDIATEK
	bool "Enable Mediatek video support"
	depends on DM_VIDEO
	select DISPLAY
	help
	  Enable Mediatek video support.
```

## drivers/video/meson/Kconfig
```kconfig
# SPDX-License-Identifier: GPL-2.0+
#
# Copyright (C) 2018 BayLibre, SAS
#
# Author: Neil Armstrong <narmstrong@baylibre.com>

config VIDEO_MESON
	bool "Enable Amlogic Meson video support"
	depends on DM_VIDEO
	select DISPLAY
	help
	  Enable Amlogic Meson Video Processing Unit video support.

config VIDEO_MESON_HDMI_FAIL_SAVE_FULL_HD
	bool "Enable HDMI fail-save FullHD mode"
	depends on VIDEO_MESON
	default y
	help
	  Force setup FullHD display mode, if proper timing cant readed.
	  from display! Its happens for some 4K display, which send
	  unsupported high timings, but same time can works as FullHD!
	  Also its will be useful for suspended or disconnected displays
```
