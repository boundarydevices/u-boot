## board/boundary/ses/Kconfig
```kconfig
if TARGET_SES

config SYS_CPU
	default "armv7"

config SYS_BOARD
	default "ses"

config SYS_VENDOR
	default "boundary"

config SYS_SOC
	default "mx6"

config SYS_CONFIG_NAME
	default "ses"

config ENV_WLMAC
	bool
	default	y

source "board/boundary/common/Kconfig"

endif
```

## board/boundary/snap/Kconfig
```kconfig
if TARGET_SNAP

config SYS_CPU
	default "armv7"

config SYS_BOARD
	default "snap"

config SYS_VENDOR
	default "boundary"

config SYS_SOC
	default "mx6"

config SYS_CONFIG_NAME
	default "snap"

source "board/boundary/common/Kconfig"

endif
```

## board/boundary/son/Kconfig
```kconfig
if TARGET_SON

config SYS_BOARD
	default "son"

config SYS_VENDOR
	default "boundary"

config SYS_CONFIG_NAME
	default "son"

source "board/boundary/common/Kconfig"

endif
```

## board/boundary/sp/Kconfig
```kconfig
if TARGET_SP

config SYS_CPU
	default "armv7"

config SYS_BOARD
	default "sp"

config SYS_VENDOR
	default "boundary"

config SYS_SOC
	default "mx6"

config SYS_CONFIG_NAME
	default "sp"

source "board/boundary/common/Kconfig"

endif
```

## board/boundary/span/Kconfig
```kconfig
if TARGET_SPAN

config SYS_BOARD
	default "span"

config SYS_VENDOR
	default "boundary"

config SYS_CONFIG_NAME
	default "span"

source "board/boundary/common/Kconfig"

endif
```

## board/boundary/ta/Kconfig
```kconfig
if TARGET_TA

config SYS_CPU
	default "armv7"

config SYS_BOARD
	default "ta"

config SYS_VENDOR
	default "boundary"

config SYS_SOC
	default "mx6"

config SYS_CONFIG_NAME
	default "ta"

source "board/boundary/common/Kconfig"

endif
```

## board/boundary/tag/Kconfig
```kconfig
if TARGET_TAG

config SYS_BOARD
	default "tag"

config SYS_VENDOR
	default "boundary"

config SYS_CONFIG_NAME
	default "tag"

source "board/boundary/common/Kconfig"

endif
```

## board/boundary/tc/Kconfig
```kconfig
if TARGET_TC

config SYS_CPU
	default "armv7"

config SYS_BOARD
	default "tc"

config SYS_VENDOR
	default "boundary"

config SYS_SOC
	default "mx6"

config SYS_CONFIG_NAME
	default "tc"

source "board/boundary/common/Kconfig"

endif
```

## board/boundary/usd/Kconfig
```kconfig
if TARGET_USD

config SYS_CPU
	default "armv7"

config SYS_BOARD
	default "usd"

config SYS_VENDOR
	default "boundary"

config SYS_SOC
	default "mx6"

config SYS_CONFIG_NAME
	default "usd"

endif
```

## board/boundary/usd_mr2/Kconfig
```kconfig
if TARGET_USD_MR2

config SYS_CPU
	default "armv7"

config SYS_BOARD
	default "usd_mr2"

config SYS_VENDOR
	default "boundary"

config SYS_SOC
	default "mx6"

config SYS_CONFIG_NAME
	default "usd_mr2"

source "board/boundary/common/Kconfig"

endif
```

## board/boundary/utc/Kconfig
```kconfig
if TARGET_UTC

config SYS_CPU
	default "armv7"

config SYS_BOARD
	default "utc"

config SYS_VENDOR
	default "boundary"

config SYS_SOC
	default "mx6"

config SYS_CONFIG_NAME
	default "utc"

endif
```

## board/mediatek/mt8188/Kconfig
```kconfig
if TARGET_MT8188
config BOARD_TYPE
	string "board override name"

config BOARD_TYPE_SET
	bool "BOARD_TYPE value given"
	default y if BOARD_TYPE != ""

config DEFCONFIG
	string "defconfig name"
endif
```

## configs/a_defconfig
```kconfig
CONFIG_ARM=y
CONFIG_TARGET_A=y
CONFIG_SYS_EXTRA_OPTIONS="IMX_CONFIG=board/boundary/nit6xlite/nit6xlite.cfg,MX6S,DDR_MB=512,DEFCONFIG=\"a\""
# CONFIG_CMD_IMLS is not set
# CONFIG_CMD_FLASH is not set
CONFIG_SPI_FLASH=y
```

## configs/acl_q2g_defconfig
```kconfig
CONFIG_ARM=y
CONFIG_ARCH_MX6=y
CONFIG_TARGET_ACL=y
CONFIG_SYS_EXTRA_OPTIONS="IMX_CONFIG=board/boundary/acl/acl2g.cfg,MX6Q,DDR_MB=2048,DEFCONFIG=\"acl_q2g\""
# CONFIG_CMD_IMLS is not set
# CONFIG_CMD_FLASH is not set
CONFIG_CMD_GPIO=y
CONFIG_SPI_FLASH=y
CONFIG_SPI_FLASH_SPANSION=y
CONFIG_SPI_FLASH_SST=y
```

## configs/acl_s512m_defconfig
```kconfig
CONFIG_ARM=y
CONFIG_ARCH_MX6=y
CONFIG_TARGET_ACL=y
CONFIG_SYS_EXTRA_OPTIONS="IMX_CONFIG=board/boundary/acl/acl512m.cfg,MX6S,DDR_MB=512,DEFCONFIG=\"acl_s512m\""
# CONFIG_CMD_IMLS is not set
# CONFIG_CMD_FLASH is not set
CONFIG_CMD_GPIO=y
CONFIG_SPI_FLASH=y
CONFIG_SPI_FLASH_SPANSION=y
CONFIG_SPI_FLASH_SST=y
```

## configs/ash2b_defconfig
```kconfig
CONFIG_ARM=y
CONFIG_ARCH_MX6=y
CONFIG_SYS_TEXT_BASE=0x17800000
CONFIG_TARGET_ASH2=y
CONFIG_SWM_DISPLAY_00_B=0x00020000
CONFIG_SWM_DISPLAY_24_A=0xffffffff
CONFIG_SWM_DISPLAY_24_B=0xfffdffff
CONFIG_ENV_VARS_UBOOT_CONFIG=y
CONFIG_SYS_EXTRA_OPTIONS="IMX_CONFIG=board/boundary/ash2/ash2.cfg,MX6DL,DDR_MB=1024,DEFCONFIG=\"ash2b\""
CONFIG_BOOTDELAY=3
CONFIG_SYS_CONSOLE_OVERWRITE_ROUTINE=y
CONFIG_SUPPORT_RAW_INITRD=y
CONFIG_BOARD_EARLY_INIT_F=y
CONFIG_HUSH_PARSER=y
CONFIG_CMD_BOOTZ=y
CONFIG_CMD_MEMTEST=y
CONFIG_SYS_ALT_MEMTEST=y
CONFIG_CMD_DFU=y
# CONFIG_CMD_FLASH is not set
CONFIG_CMD_GPIO=y
CONFIG_CMD_GPT=y
# CONFIG_RANDOM_UUID is not set
CONFIG_CMD_I2C=y
CONFIG_CMD_MMC=y
CONFIG_CMD_PART=y
CONFIG_CMD_SF=y
CONFIG_CMD_USB=y
CONFIG_CMD_USB_MASS_STORAGE=y
CONFIG_CMD_DHCP=y
CONFIG_CMD_MII=y
CONFIG_CMD_PING=y
CONFIG_CMD_BMP=y
CONFIG_CMD_CACHE=y
CONFIG_CMD_TIME=y
CONFIG_CMD_EXT2=y
CONFIG_CMD_EXT4=y
CONFIG_CMD_EXT4_WRITE=y
CONFIG_CMD_FAT=y
CONFIG_CMD_FS_GENERIC=y
CONFIG_PARTITION_TYPE_GUID=y
CONFIG_ENV_IS_IN_SPI_FLASH=y
CONFIG_USB_FUNCTION_FASTBOOT=y
CONFIG_FASTBOOT_BUF_ADDR=0x12000000
CONFIG_FASTBOOT_BUF_SIZE=0x26000000
CONFIG_FASTBOOT_FLASH=y
CONFIG_FASTBOOT_FLASH_MMC_DEV=0
CONFIG_FSL_ESDHC=y
CONFIG_SPI_FLASH=y
CONFIG_SPI_FLASH_GIGADEVICE=y
CONFIG_SPI_FLASH_SPANSION=y
CONFIG_SPI_FLASH_SST=y
CONFIG_PHYLIB=y
CONFIG_PHY_ATHEROS=y
CONFIG_NETDEVICES=y
CONFIG_FEC_MXC=y
CONFIG_SPI=y
CONFIG_MXC_SPI=y
CONFIG_USB=y
CONFIG_USB_STORAGE=y
CONFIG_USB_KEYBOARD=y
CONFIG_SYS_USB_EVENT_POLL_VIA_CONTROL_EP=y
CONFIG_USB_GADGET=y
CONFIG_USB_GADGET_MANUFACTURER="Boundary"
CONFIG_USB_GADGET_VENDOR_NUM=0x3016
CONFIG_USB_GADGET_PRODUCT_NUM=0x0001
CONFIG_CI_UDC=y
CONFIG_USB_ETHER=y
CONFIG_USB_ETH_CDC=y
CONFIG_USB_HOST_ETHER=y
CONFIG_USB_ETHER_ASIX=y
CONFIG_USB_ETHER_MCS7830=y
CONFIG_USB_ETHER_SMSC95XX=y
CONFIG_VIDEO=y
# CONFIG_VIDEO_SW_CURSOR is not set
CONFIG_OF_LIBFDT=y
```

## configs/ash_defconfig
```kconfig
CONFIG_ARM=y
CONFIG_TARGET_ASH=y
CONFIG_SYS_EXTRA_OPTIONS="IMX_CONFIG=board/boundary/ash/ash.cfg,MX6DL,DDR_MB=1024,DEFCONFIG=\"ash\""
# CONFIG_CMD_IMLS is not set
# CONFIG_CMD_FLASH is not set
CONFIG_SPI_FLASH=y
```

## configs/bt2_2g_defconfig
```kconfig
CONFIG_ARM=y
CONFIG_TARGET_BT2=y
CONFIG_SYS_EXTRA_OPTIONS="IMX_CONFIG=board/boundary/bt2/bt2g.cfg,MX6Q,DDR_MB=2048,DEFCONFIG=\"bt2_2g\""
# CONFIG_CMD_IMLS is not set
# CONFIG_CMD_FLASH is not set
CONFIG_SPI_FLASH=y
```

## configs/bt2_4g_defconfig
```kconfig
CONFIG_ARM=y
CONFIG_TARGET_BT2=y
CONFIG_SYS_EXTRA_OPTIONS="IMX_CONFIG=board/boundary/bt2/bt4g.cfg,MX6Q,DDR_MB=3840,DEFCONFIG=\"bt2_4g\""
# CONFIG_CMD_IMLS is not set
# CONFIG_CMD_FLASH is not set
CONFIG_SPI_FLASH=y
```

## configs/bt2g_defconfig
```kconfig
CONFIG_ARM=y
CONFIG_TARGET_BT=y
CONFIG_SYS_EXTRA_OPTIONS="IMX_CONFIG=board/boundary/bt/bt2g.cfg,MX6Q,DDR_MB=2048,DEFCONFIG=\"bt2g\""
# CONFIG_CMD_IMLS is not set
# CONFIG_CMD_FLASH is not set
CONFIG_SPI_FLASH=y
```

## configs/bt4g_defconfig
```kconfig
CONFIG_ARM=y
CONFIG_TARGET_BT=y
CONFIG_SYS_EXTRA_OPTIONS="IMX_CONFIG=board/boundary/bt/bt4g.cfg,MX6Q,DDR_MB=3840,DEFCONFIG=\"bt4g\""
# CONFIG_CMD_IMLS is not set
# CONFIG_CMD_FLASH is not set
CONFIG_SPI_FLASH=y
```

## configs/cad_defconfig
```kconfig
CONFIG_ARM=y
CONFIG_TARGET_CAD=y
CONFIG_SYS_EXTRA_OPTIONS="IMX_CONFIG=board/boundary/cad/cad.cfg,MX6S,DDR_MB=1024,DEFCONFIG=\"cad\""
# CONFIG_CMD_IMLS is not set
# CONFIG_CMD_FLASH is not set
CONFIG_SPI_FLASH=y
```

## configs/cob_defconfig
```kconfig
CONFIG_ARM=y
CONFIG_TARGET_COB=y
CONFIG_SYS_EXTRA_OPTIONS="IMX_CONFIG=board/boundary/cob/cob.cfg,MX6Q,DDR_MB=1024,DEFCONFIG=\"cob\""
# CONFIG_CMD_IMLS is not set
# CONFIG_CMD_FLASH is not set
CONFIG_SPI_FLASH=y
```

## configs/elo_defconfig
```kconfig
CONFIG_SYS_EXTRA_OPTIONS="IMX_CONFIG=board/boundary/elo/elo.cfg,MX6QDL,DDR_MB=1024"
CONFIG_ARM=y
CONFIG_TARGET_ELO=y
```
