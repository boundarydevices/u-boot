## board/boundary/neol/Kconfig
```kconfig
if TARGET_NEOL

config SYS_CPU
	default "armv7"

config SYS_BOARD
	default "neol"

config SYS_VENDOR
	default "boundary"

config SYS_SOC
	default "mx6"

config SYS_CONFIG_NAME
	default "neol"

config ENV_WLMAC
	bool
	default	y

source "board/boundary/common/Kconfig"

endif
```

## board/boundary/nit6xlite/Kconfig
```kconfig
if TARGET_NIT6XLITE

config SYS_CPU
	default "armv7"

config SYS_BOARD
	default "nit6xlite"

config SYS_VENDOR
	default "boundary"

config SYS_SOC
	default "mx6"

config SYS_CONFIG_NAME
	default "nit6xlite"

config ENV_BD_ADDR
	bool
	default	y

source "board/boundary/common/Kconfig"

endif
```

## board/boundary/nitrogen51_e/Kconfig
```kconfig
if TARGET_NITROGEN51_E

config SYS_CPU
	default "armv7"

config SYS_BOARD
	default "nitrogen51_e"

config SYS_VENDOR
	default "boundary"

config SYS_SOC
	default "mx5"

config SYS_CONFIG_NAME
	default "nitrogen51_e"

config BOARD_LATE_SPECIFIC_INIT
	bool
	default	y

source "board/boundary/common/Kconfig"

endif
```

## board/boundary/nitrogen51_vm/Kconfig
```kconfig
if TARGET_NITROGEN51_VM

config SYS_CPU
	default "armv7"

config SYS_BOARD
	default "nitrogen51_vm"

config SYS_VENDOR
	default "boundary"

config SYS_SOC
	default "mx5"

config SYS_CONFIG_NAME
	default "nitrogen51_vm"

config BOARD_LATE_SPECIFIC_INIT
	bool
	default	y

source "board/boundary/common/Kconfig"

endif
```

## board/boundary/nitrogen6_max/Kconfig
```kconfig
if TARGET_NITROGEN6_MAX

config SYS_CPU
	default "armv7"

config SYS_BOARD
	default "nitrogen6_max"

config SYS_VENDOR
	default "boundary"

config SYS_SOC
	default "mx6"

config SYS_CONFIG_NAME
	default "nitrogen6_max"

config ENV_WLMAC
	bool
	default	y

source "board/boundary/common/Kconfig"

endif
```

## board/boundary/nitrogen6_scm/Kconfig
```kconfig
if TARGET_NITROGEN6_SCM

config SYS_CPU
	default "armv7"

config SYS_BOARD
	default "nitrogen6_scm"

config SYS_VENDOR
	default "boundary"

config SYS_SOC
	default "mx6"

config SYS_CONFIG_NAME
	default "nitrogen6_scm"

source "board/boundary/common/Kconfig"

endif
```

## board/boundary/nitrogen6_som2/Kconfig
```kconfig
if TARGET_NITROGEN6_SOM2

config SYS_BOARD
	default "nitrogen6_som2"

config SYS_VENDOR
	default "boundary"

config SYS_SOC
	default "mx6"

config SYS_CONFIG_NAME
	default "nitrogen6_som2"

config ENV_WLMAC
	bool
	default	y

source "board/boundary/common/Kconfig"

endif
```

## board/boundary/nitrogen6_vm/Kconfig
```kconfig
if TARGET_NITROGEN6_VM

config SYS_CPU
	default "armv7"

config SYS_BOARD
	default "nitrogen6_vm"

config SYS_VENDOR
	default "boundary"

config SYS_SOC
	default "mx6"

config SYS_CONFIG_NAME
	default "nitrogen6_vm"

source "board/boundary/common/Kconfig"

endif
```

## board/boundary/nitrogen6sx/Kconfig
```kconfig
if TARGET_NITROGEN6SX

config SYS_CPU
	default "armv7"

config SYS_BOARD
	default "nitrogen6sx"

config SYS_VENDOR
	default "boundary"

config SYS_SOC
	default "mx6"

config SYS_CONFIG_NAME
	default "nitrogen6sx"

source "board/boundary/common/Kconfig"

endif
```

## board/boundary/nitrogen6x/Kconfig
```kconfig
if TARGET_NITROGEN6X

config SYS_BOARD
	default "nitrogen6x"

config SYS_VENDOR
	default "boundary"

config SYS_CONFIG_NAME
	default "nitrogen6x"

config ENV_WLMAC
	bool
	default	y

source "board/boundary/common/Kconfig"

endif
```

## board/boundary/nitrogen7/Kconfig
```kconfig
if TARGET_NITROGEN7

config SYS_BOARD
	default "nitrogen7"

config SYS_VENDOR
	default "boundary"

config SYS_SOC
	default "mx7"

config SYS_CONFIG_NAME
	default "nitrogen7"

config ENV_WLMAC
	bool
	default	y

source "board/boundary/common/Kconfig"

endif
```

## board/boundary/nitrogen8_2eth/Kconfig
```kconfig
if TARGET_NITROGEN8_2ETH

config SYS_BOARD
	default "nitrogen8_2eth"

config SYS_VENDOR
	default "boundary"

config SYS_CONFIG_NAME
	default "nitrogen8_2eth"

config DDR_RANK_BITS
	int "ddr rank bits"
	default 1

source "board/boundary/common/Kconfig"

endif
```

## board/boundary/nitrogen8_lite/Kconfig
```kconfig
if TARGET_NITROGEN8_LITE

config SYS_BOARD
	default "nitrogen8_lite"

config SYS_VENDOR
	default "boundary"

config SYS_CONFIG_NAME
	default "nitrogen8_lite"

config ENV_ON_SD
	bool "env and u-boot loaded from sd card"

source "board/boundary/common/Kconfig"

endif
```

## board/boundary/nitrogen8_nano/Kconfig
```kconfig
if TARGET_NITROGEN8_NANO

config SYS_BOARD
	default "nitrogen8_nano"

config SYS_VENDOR
	default "boundary"

config SYS_CONFIG_NAME
	default "nitrogen8_nano"

source "board/boundary/common/Kconfig"

endif
```

## board/boundary/nitrogen8m_rev0/Kconfig
```kconfig
if TARGET_NITROGEN8M_REV0

config SYS_BOARD
	default "nitrogen8m_rev0"

config SYS_VENDOR
	default "boundary"

config SYS_CONFIG_NAME
	default "nitrogen8m_rev0"

source "board/freescale/common/Kconfig"

endif
```

## board/boundary/nitrogen8m_som/Kconfig
```kconfig
if TARGET_NITROGEN8M_SOM

config SYS_BOARD
	default "nitrogen8m_som"

config SYS_VENDOR
	default "boundary"

config SYS_CONFIG_NAME
	default "nitrogen8m_som"

config USDHC2_SD
	bool "An SD card is on carrier instead of wifi"

source "board/boundary/common/Kconfig"

endif
```

## board/boundary/nitrogen8mm_tab/Kconfig
```kconfig
if TARGET_NITROGEN8MM_TAB || TARGET_NITROGEN8MN_TAB

config BOARD_TYPE
	string
	depends on IMX8MN
	default "nitrogen8mn_tab" if IMX8MN

config SYS_BOARD
	default "nitrogen8mm_tab"

config SYS_VENDOR
	default "boundary"

config SYS_CONFIG_NAME
	default "nitrogen8mm_tab"

source "board/boundary/common/Kconfig"

endif
```

## board/boundary/nitrogen8mp_vm/Kconfig
```kconfig
if TARGET_NITROGEN8MP_VM

config SYS_BOARD
	default "nitrogen8mp_vm"

config SYS_VENDOR
	default "boundary"

config SYS_CONFIG_NAME
	default "nitrogen8mp_vm"

source "board/boundary/common/Kconfig"

endif
```

## board/boundary/nitrogen93/Kconfig
```kconfig
if TARGET_IMX93_NITROGEN_SMARC

config SYS_BOARD
	default "nitrogen93"

config SYS_VENDOR
	default "boundary"

config SYS_CONFIG_NAME
	default "imx93_nitrogen_smarc"

choice
	prompt "Select DDR Type"
	default IMX93_NITROGEN_SMARC_LPDDR4 if TARGET_IMX93_NITROGEN_SMARC

config IMX93_NITROGEN_SMARC_LPDDR4
	bool "Using LPDDR4 Timing and PMIC voltage"
	# IMX9_LPDDR4X is used for LPDDR4 AND LPDDR4X
	select IMX9_LPDDR4X
	help
	  Select the LPDDR4 timing and 1.1V VDDQ

endchoice

endif
```

## board/boundary/nw/Kconfig
```kconfig
if TARGET_NW

config SYS_CPU
	default "armv7"

config SYS_BOARD
	default "nw"

config SYS_VENDOR
	default "boundary"

config SYS_SOC
	default "mx6"

config SYS_CONFIG_NAME
	default "nw"

config ENV_BD_ADDR
	bool
	default	y

source "board/boundary/common/Kconfig"

endif
```

## board/boundary/oc/Kconfig
```kconfig
if TARGET_OC

config SYS_CPU
	default "armv7"

config SYS_BOARD
	default "oc"

config SYS_VENDOR
	default "boundary"

config SYS_SOC
	default "mx6"

config SYS_CONFIG_NAME
	default "oc"

source "board/boundary/common/Kconfig"

endif
```

## board/boundary/per/Kconfig
```kconfig
if TARGET_PER

config SYS_CPU
	default "armv7"

config SYS_BOARD
	default "per"

config SYS_VENDOR
	default "boundary"

config SYS_SOC
	default "mx6"

config SYS_CONFIG_NAME
	default "per"

source "board/boundary/common/Kconfig"

endif
```

## board/boundary/rc/Kconfig
```kconfig
if TARGET_RC

config SYS_CPU
	default "armv7"

config SYS_BOARD
	default "rc"

config SYS_VENDOR
	default "boundary"

config SYS_SOC
	default "mx6"

config SYS_CONFIG_NAME
	default "rc"

config ENV_WLMAC
	bool
	default	y

source "board/boundary/common/Kconfig"

endif
```

## board/boundary/rta/Kconfig
```kconfig
if TARGET_RTA

config SYS_CPU
	default "armv7"

config SYS_BOARD
	default "rta"

config SYS_VENDOR
	default "boundary"

config SYS_SOC
	default "mx6"

config SYS_CONFIG_NAME
	default "rta"

source "board/boundary/common/Kconfig"

endif
```

## board/boundary/s/Kconfig
```kconfig
if TARGET_S

config SYS_CPU
	default "armv7"

config SYS_BOARD
	default "s"

config SYS_VENDOR
	default "boundary"

config SYS_SOC
	default "mx6"

config SYS_CONFIG_NAME
	default "s"

config ENV_WLMAC
	bool
	default	y

source "board/boundary/common/Kconfig"

endif
```
