## board/boundary/dash/Kconfig
```kconfig
if TARGET_DASH

config SYS_CPU
	default "armv7"

config SYS_BOARD
	default "dash"

config SYS_VENDOR
	default "boundary"

config SYS_SOC
	default "mx6"

config SYS_CONFIG_NAME
	default "dash"

source "board/boundary/common/Kconfig"

endif
```

## board/boundary/ds/Kconfig
```kconfig
if TARGET_DS

config SYS_BOARD
	default "ds"

config SYS_VENDOR
	default "boundary"

config SYS_CONFIG_NAME
	default "ds"

source "board/boundary/common/Kconfig"

endif
```

## board/boundary/dwe/Kconfig
```kconfig
if TARGET_DWE

config SYS_BOARD
	default "dwe"

config SYS_VENDOR
	default "boundary"

config SYS_CONFIG_NAME
	default "dwe"

source "board/boundary/common/Kconfig"

endif
```

## board/boundary/em/Kconfig
```kconfig
if TARGET_EM

config SYS_BOARD
	default "em"

config SYS_VENDOR
	default "boundary"

config SYS_CONFIG_NAME
	default "em"

source "board/boundary/common/Kconfig"

endif
```

## board/boundary/eo/Kconfig
```kconfig
if TARGET_EO

config SYS_CPU
	default "armv7"

config SYS_BOARD
	default "eo"

config SYS_VENDOR
	default "boundary"

config SYS_SOC
	default "mx6"

config SYS_CONFIG_NAME
	default "eo"

config ENV_WLMAC
	bool
	default	y

config PRINT_TIME_RV4162
	bool
	default	y

source "board/boundary/common/Kconfig"

endif
```

## board/boundary/h4/Kconfig
```kconfig
if TARGET_H4

config SYS_CPU
	default "armv7"

config SYS_BOARD
	default "h4"

config SYS_VENDOR
	default "boundary"

config SYS_SOC
	default "mx6"

config SYS_CONFIG_NAME
	default "h4"

source "board/boundary/common/Kconfig"

endif
```

## board/boundary/hl/Kconfig
```kconfig
if TARGET_HL

config SYS_CPU
	default "armv7"

config SYS_BOARD
	default "hl"

config SYS_VENDOR
	default "boundary"

config SYS_SOC
	default "mx6"

config SYS_CONFIG_NAME
	default "hl"

config ENV_WLMAC
	bool
	default	y

source "board/boundary/common/Kconfig"

endif
```

## board/boundary/hl8mm/Kconfig
```kconfig
if TARGET_HL8MM

config SYS_BOARD
	default "hl8mm"

config SYS_VENDOR
	default "boundary"

config SYS_CONFIG_NAME
	default "hl8mm"

source "board/boundary/common/Kconfig"

endif
```

## board/boundary/hp/Kconfig
```kconfig
if TARGET_HP

config SYS_CPU
	default "armv7"

config SYS_BOARD
	default "hp"

config SYS_VENDOR
	default "boundary"

config SYS_SOC
	default "mx6"

config SYS_CONFIG_NAME
	default "hp"

config ENV_WLMAC
	bool
	default	y

source "board/boundary/common/Kconfig"

endif
```

## board/boundary/imx8mp_mmr/Kconfig
```kconfig
if TARGET_IMX8MP_MMR

config SYS_BOARD
	default "imx8mp_mmr"

config SYS_VENDOR
	default "boundary"

config SYS_CONFIG_NAME
	default "imx8mp_mmr"

source "board/boundary/common/Kconfig"

endif
```

## board/boundary/imx8ulp_nitrogen_som/Kconfig
```kconfig
if TARGET_IMX8ULP_NITROGEN_SOM

config SYS_BOARD
	default "imx8ulp_nitrogen_som"

config SYS_VENDOR
	default "boundary"

config SYS_CONFIG_NAME
	default "imx8ulp_nitrogen_som"

endif
```

## board/boundary/imx93_smarc/Kconfig
```kconfig
if TARGET_IMX93_BD_SMARC

config SYS_BOARD
	default "imx93_smarc"

config SYS_VENDOR
	default "boundary"

config SYS_CONFIG_NAME
	default "imx93_bd_smarc"

choice
	prompt "Select DDR Type"
	default IMX93_BD_SMARC_LPDDR4 if TARGET_IMX93_BD_SMARC

config IMX93_BD_SMARC_LPDDR4
	bool "Using LPDDR4 Timing and PMIC voltage"
	# IMX9_LPDDR4X is used for LPDDR4 AND LPDDR4X
	select IMX9_LPDDR4X
	help
	  Select the LPDDR4 timing and 1.1V VDDQ

endchoice

endif
```

## board/boundary/insp/Kconfig
```kconfig
if TARGET_INSP

config SYS_CPU
	default "armv7"

config SYS_BOARD
	default "insp"

config SYS_VENDOR
	default "boundary"

config SYS_SOC
	default "mx6"

config SYS_CONFIG_NAME
	default "insp"

config ENV_WLMAC
	bool
	default	y

source "board/boundary/common/Kconfig"

endif
```

## board/boundary/ioc/Kconfig
```kconfig
if TARGET_IOC

config SYS_CPU
	default "armv7"

config SYS_BOARD
	default "ioc"

config SYS_VENDOR
	default "boundary"

config SYS_SOC
	default "mx6"

config SYS_CONFIG_NAME
	default "ioc"

config ENV_WLMAC
	bool
	default	y

source "board/boundary/common/Kconfig"

endif
```

## board/boundary/jde/Kconfig
```kconfig
if TARGET_JDE

config SYS_CPU
	default "armv7"

config SYS_BOARD
	default "jde"

config SYS_VENDOR
	default "boundary"

config SYS_SOC
	default "mx6"

config SYS_CONFIG_NAME
	default "jde"

source "board/boundary/common/Kconfig"

endif
```

## board/boundary/jlm/Kconfig
```kconfig
if TARGET_JLM

config SYS_BOARD
	default "jlm"

config SYS_VENDOR
	default "boundary"

config SYS_SOC
	default "mx6"

config SYS_CONFIG_NAME
	default "jlm"

config ENV_WLMAC
	bool
	default	y

source "board/boundary/common/Kconfig"

endif
```

## board/boundary/kea/Kconfig
```kconfig
if TARGET_KEA

config SYS_BOARD
	default "kea"

config SYS_VENDOR
	default "boundary"

config SYS_CONFIG_NAME
	default "kea"

source "board/boundary/common/Kconfig"

endif
```

## board/boundary/ls/Kconfig
```kconfig
if TARGET_LS

config SYS_CPU
	default "armv7"

config SYS_BOARD
	default "ls"

config SYS_VENDOR
	default "boundary"

config SYS_SOC
	default "mx6"

config SYS_CONFIG_NAME
	default "ls"

config ENV_WLMAC
	bool
	default	y

source "board/boundary/common/Kconfig"

endif
```

## board/boundary/ltch/Kconfig
```kconfig
if TARGET_LTCH

config SYS_CPU
	default "armv7"

config SYS_BOARD
	default "ltch"

config SYS_VENDOR
	default "boundary"

config SYS_SOC
	default "mx6"

config SYS_CONFIG_NAME
	default "ltch"

config ENV_WLMAC
	bool
	default	y

source "board/boundary/common/Kconfig"

endif
```

## board/boundary/mcs/Kconfig
```kconfig
if TARGET_MCS

config SYS_CPU
	default "armv7"

config SYS_BOARD
	default "mcs"

config SYS_VENDOR
	default "boundary"

config SYS_SOC
	default "mx6"

config SYS_CONFIG_NAME
	default "mcs"

source "board/boundary/common/Kconfig"

endif
```

## board/boundary/med/Kconfig
```kconfig
if TARGET_MED

config SYS_CPU
	default "armv7"

config SYS_BOARD
	default "med"

config SYS_VENDOR
	default "boundary"

config SYS_SOC
	default "mx6"

config SYS_CONFIG_NAME
	default "med"

source "board/boundary/common/Kconfig"

endif
```

## board/boundary/moo/Kconfig
```kconfig
if TARGET_MOO

config SYS_BOARD
	default "moo"

config SYS_VENDOR
	default "boundary"

config SYS_CONFIG_NAME
	default "moo"

source "board/boundary/common/Kconfig"

endif
```

## board/boundary/mt8390-tungsten-smarc/Kconfig
```kconfig
if TARGET_MT8390_TUNGSTEN_SMARC || TARGET_MT8370_TUNGSTEN_SMARC
source "board/boundary/common/Kconfig"

config BOARD_TYPE
	string
	depends on TARGET_MT8370_TUNGSTEN_SMARC
	default "mt8370-tungsten-smarc" if TARGET_MT8370_TUNGSTEN_SMARC

endif
```

## board/boundary/mtp/Kconfig
```kconfig
if TARGET_MTP

config SYS_CPU
	default "armv7"

config SYS_BOARD
	default "mtp"

config SYS_VENDOR
	default "boundary"

config SYS_SOC
	default "mx6"

config SYS_CONFIG_NAME
	default "mtp"

config ENV_WLMAC
	bool
	default	y

source "board/boundary/common/Kconfig"

endif
```

## board/boundary/mx6_r/Kconfig
```kconfig
if TARGET_MX6_R

config SYS_CPU
	default "armv7"

config SYS_BOARD
	default "mx6_r"

config SYS_VENDOR
	default "boundary"

config SYS_SOC
	default "mx6"

config SYS_CONFIG_NAME
	default "mx6_r"

source "board/boundary/common/Kconfig"

endif
```
