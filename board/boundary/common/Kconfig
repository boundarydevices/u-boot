## board/boundary/imx8mm_nitrogen/Kconfig
```kconfig
if TARGET_NITROGEN8MM_SOM || TARGET_NITROGEN8MM

config SYS_BOARD
	default "imx8mm_nitrogen"

config DEFCONFIG
        string "unknown"

config SYS_VENDOR
	default "boundary"

config SYS_CONFIG_NAME
	default "imx8mm_nitrogen"

config IMX_CONFIG
        default "board/boundary/imx8mm_nitrogen/imximage-8mm.cfg"

config IMX8M_1G_MEMORY
        bool "imx8m 1GB memory size"

config IMX8M_2GR1_MEMORY
	bool "imx8m 2GB rank 1 memory size"

config DEFCONFIG
	string "unknown"

endif
```

## board/boundary/imx8mm_nitrogen_smarc/Kconfig
```kconfig
if TARGET_IMX8MM_NITROGEN_SMARC || TARGET_IMX8MN_NITROGEN_SMARC

config BOARD_TYPE
	string
	depends on IMX8MN
	default "imx8mn_nitrogen_smarc" if IMX8MN

config CMD_FBPANEL
	bool "Enable fbpanel command"

config DEFCONFIG
        string "unknown"

config SYS_BOARD
	default "imx8mm_nitrogen_smarc"

config SYS_VENDOR
	default "boundary"

config SYS_CONFIG_NAME
	default "imx8mm_nitrogen_smarc"

config DRATE_BYTE
	int
	default 0

config IMX_CONFIG
        default "board/boundary/imx8mm_nitrogen_smarc/imximage-8mm.cfg"

config IMX8M_1G_MEMORY
        bool "imx8m 1GB memory size"

# source "board/boundary/common/Kconfig"

endif
```

## board/boundary/imx8mp_nitrogen_smarc/Kconfig
```kconfig
if TARGET_IMX8MP_NITROGEN_SMARC

config SYS_BOARD
	default "imx8mp_nitrogen_smarc"

config SYS_CONFIG_NAME
	default "imx8mp_nitrogen_smarc"

config NITROGEN_SMARC_DEFCONFIG
	string "unknown"

config SYS_VENDOR
	default "boundary"

config IMX8M_4G_LPDDR4
	bool "imx8m 4GB memory size"

config IMX8M_8G_LPDDR4
	bool "imx8m 8GB memory size"

config IMX_CONFIG
	default "board/boundary/imx8mp_nitrogen_smarc/imximage-8mp-lpddr4.cfg"

source "board/boundary/common/Kconfig"
endif
```

## board/boundary/imx8mp_tag/Kconfig
```kconfig
if TARGET_IMX8MP_TAG

config SYS_BOARD
	default "imx8mp_tag"

config SYS_VENDOR
	default "boundary"

config SYS_CONFIG_NAME
	default "imx8mp_tag"

source "board/boundary/common/Kconfig"

endif
```

## board/boundary/imx8ulp_porpoise/Kconfig
```kconfig
if TARGET_IMX8ULP_PORPOISE

config SYS_BOARD
	default "imx8ulp_porpoise"

config SYS_VENDOR
	default "boundary"

config SYS_CONFIG_NAME
	default "imx8ulp_porpoise"

endif
```

## board/boundary/imx95_nitrogen_smarc/Kconfig
```kconfig
if TARGET_IMX95_NITROGEN_SMARC

config SYS_BOARD
	default "imx95_nitrogen_smarc"

config SYS_VENDOR
	default "boundary"

config SYS_CONFIG_NAME
	default "imx95_nitrogen_smarc"

endif
```

## board/boundary/nitrogen8m/Kconfig
```kconfig
if TARGET_NITROGEN8M

config SYS_BOARD
	default "nitrogen8m"

config SYS_VENDOR
	default "boundary"

config SYS_CONFIG_NAME
	default "nitrogen8m"

config IMX_CONFIG
	default "arch/arm/mach-imx/imx8m/imximage.cfg"

config DEFCONFIG
	string "unknown"

endif
```

## board/boundary/nitrogen8mm/Kconfig
```kconfig
if TARGET_NITROGEN8MM_SOM || TARGET_NITROGEN8MM

config SYS_BOARD
	default "nitrogen8mm"

config SYS_VENDOR
	default "boundary"

config SYS_CONFIG_NAME
	default "nitrogen8mm"

config IMX_CONFIG
        default "board/boundary/nitrogen8mm/imximage-8mm.cfg"

config IMX8M_1G_MEMORY
        bool "imx8m 1GB memory size"

config DEFCONFIG
	string "unknown"

endif
```

## board/boundary/nitrogen8mm_som/Kconfig
```kconfig
if TARGET_NITROGEN8MM_SOM || TARGET_NITROGEN8MM

#config BOARD_TYPE
#	string
#	default "nitrogen8mm"

config SYS_BOARD
	default "nitrogen8mm_som"

config SYS_VENDOR
	default "boundary"

config SYS_CONFIG_NAME
	default "nitrogen8mm_som"

config IMX_CONFIG
        default "board/boundary/nitrogen8mm_som/imximage-8mm.cfg"

config IMX8M_1G_MEMORY
        bool "imx8m 1GB memory size"

config DEFCONFIG
	string "unknown"

endif
```

## board/boundary/nitrogen8mp/Kconfig
```kconfig
if TARGET_IMX8MP_NITROGEN_SOM

config SYS_BOARD
	default "nitrogen8mp"

config SYS_CONFIG_NAME
	default "nitrogen8mp"

config NITROGEN_SMARC_DEFCONFIG
	string "unknown"

config SYS_VENDOR
	default "boundary"

config IMX8M_4G_LPDDR4
	bool "imx8m 4GB memory size"

config IMX8M_8G_LPDDR4
	bool "imx8m 8GB memory size"

config IMX_CONFIG
	default "board/boundary/nitrogen8mp/imximage-8mp-lpddr4.cfg"

source "board/boundary/common/Kconfig"
endif
```

## board/ezurio/carbon-am62/Kconfig
```kconfig
# SPDX-License-Identifier: GPL-2.0+
#
# Copyright (C) 2024 Ezurio LLC
#

if TARGET_CARBON_AM62_A53

config SYS_BOARD
       default "carbon-am62"

config SYS_VENDOR
       default "ezurio"

config SYS_CONFIG_NAME
       default "carbon-am62"

config DEFCONFIG
        string "unknown"

endif

if TARGET_CARBON_AM62_R5

config SYS_BOARD
       default "carbon-am62"

config SYS_VENDOR
       default "ezurio"

config SYS_CONFIG_NAME
       default "carbon-am62"

config SPL_LDSCRIPT
	default "arch/arm/mach-omap2/u-boot-spl.lds"

# source "board/ti/common/Kconfig"

endif
```

## configs/carbon_am62_a53_defconfig
```kconfig
CONFIG_ARM=y
CONFIG_ARCH_K3=y
CONFIG_SYS_MALLOC_F_LEN=0x8000
CONFIG_SPL_GPIO=y
CONFIG_SPL_LIBCOMMON_SUPPORT=y
CONFIG_SPL_LIBGENERIC_SUPPORT=y
CONFIG_NR_DRAM_BANKS=2
CONFIG_SOC_K3_AM625=y
CONFIG_TARGET_CARBON_AM62_A53=y
CONFIG_HAS_CUSTOM_SYS_INIT_SP_ADDR=y
CONFIG_CUSTOM_SYS_INIT_SP_ADDR=0x80b80000
CONFIG_SF_DEFAULT_SPEED=25000000
CONFIG_DM_GPIO=y
CONFIG_DEFAULT_DEVICE_TREE="k3-am625-carbon"
CONFIG_DEFCONFIG="carbon_am62_a53"
CONFIG_SPL_TEXT_BASE=0x80080000
CONFIG_OF_LIBFDT_OVERLAY=y
CONFIG_DM_RESET=y
CONFIG_SPL_MMC=y
CONFIG_SPL_SERIAL=y
CONFIG_SPL_STACK_R_ADDR=0x82000000
CONFIG_SPL_SIZE_LIMIT=0x80000
CONFIG_SPL_SIZE_LIMIT_PROVIDE_STACK=0x800
CONFIG_SPL_FS_FAT=y
CONFIG_SPL_LIBDISK_SUPPORT=y
# CONFIG_PSCI_RESET is not set
# CONFIG_SYS_MALLOC_CLEAR_ON_INIT is not set
CONFIG_SPL_LOAD_FIT=y
CONFIG_SPL_LOAD_FIT_ADDRESS=0x81000000
CONFIG_BOOTSTD_FULL=y
CONFIG_OF_BOARD_SETUP=y
CONFIG_BOARD_LATE_INIT=y
CONFIG_BLOBLIST=y
CONFIG_BLOBLIST_ADDR=0x80D00000
CONFIG_SPL_MAX_SIZE=0x80000
CONFIG_SPL_HAS_BSS_LINKER_SECTION=y
CONFIG_SPL_BSS_START_ADDR=0x80c80000
CONFIG_SPL_BSS_MAX_SIZE=0x80000
CONFIG_SPL_SYS_REPORT_STACK_F_USAGE=y
CONFIG_SPL_BOARD_INIT=y
CONFIG_SPL_SYS_MALLOC_SIMPLE=y
CONFIG_SPL_STACK_R=y
CONFIG_SYS_MMCSD_RAW_MODE_U_BOOT_USE_SECTOR=y
CONFIG_SYS_MMCSD_RAW_MODE_U_BOOT_SECTOR=0x1400
CONFIG_SPL_ENV_SUPPORT=y
CONFIG_SPL_FS_LOAD_PAYLOAD_NAME="u-boot.img"
CONFIG_SPL_I2C=y
CONFIG_SPL_DM_MAILBOX=y
CONFIG_SPL_POWER_DOMAIN=y
# CONFIG_SPL_SPI_FLASH_TINY is not set
CONFIG_SPL_THERMAL=y
CONFIG_SPL_YMODEM_SUPPORT=y
CONFIG_CMD_EEPROM=y
CONFIG_CMD_GPIO=y
CONFIG_CMD_MEMTEST=y
CONFIG_SYS_MEMTEST_START=0x0083000000
CONFIG_SYS_MEMTEST_END=0x0090000000
CONFIG_CMD_MMC=y
CONFIG_CMD_DDRSS=y
CONFIG_CMD_I2C=y
CONFIG_CMD_USB_MASS_STORAGE=y
CONFIG_MMC_SPEED_MODE_SET=y
CONFIG_OF_CONTROL=y
CONFIG_SPL_OF_CONTROL=y
CONFIG_MULTI_DTB_FIT=y
CONFIG_SPL_MULTI_DTB_FIT=y
CONFIG_SPL_MULTI_DTB_FIT_NO_COMPRESSION=y
CONFIG_NET_RANDOM_ETHADDR=y
CONFIG_SPL_DM=y
CONFIG_SPL_DM_SEQ_ALIAS=y
CONFIG_REGMAP=y
CONFIG_SPL_REGMAP=y
CONFIG_SPL_SYSCON=y
CONFIG_SYSCON=y
CONFIG_SPL_OF_TRANSLATE=y
CONFIG_CLK=y
CONFIG_SPL_CLK=y
CONFIG_CLK_TI_SCI=y
CONFIG_DMA_CHANNELS=y
CONFIG_TI_K3_NAVSS_UDMA=y
CONFIG_TI_SCI_PROTOCOL=y
CONFIG_SPL_DM_GPIO_LOOKUP_LABEL=y
CONFIG_DA8XX_GPIO=y
CONFIG_DM_PCA953X=y
CONFIG_SPL_DM_PCA953X=y
CONFIG_DM_I2C=y
CONFIG_SYS_I2C_OMAP24XX=y
CONFIG_DM_MAILBOX=y
CONFIG_K3_SEC_PROXY=y
CONFIG_FS_LOADER=y
CONFIG_SUPPORT_EMMC_BOOT=y
CONFIG_MMC_IO_VOLTAGE=y
CONFIG_SPL_MMC_IO_VOLTAGE=y
CONFIG_MMC_UHS_SUPPORT=y
CONFIG_SPL_MMC_UHS_SUPPORT=y
CONFIG_MMC_HS200_SUPPORT=y
CONFIG_SPL_MMC_HS200_SUPPORT=y
CONFIG_MMC_SDHCI=y
CONFIG_MMC_SDHCI_ADMA=y
CONFIG_SPL_MMC_SDHCI_ADMA=y
CONFIG_MMC_SDHCI_AM654=y
CONFIG_MTD=y
CONFIG_PHY_TI_DP83867=y
CONFIG_PHY_FIXED=y
CONFIG_TI_AM65_CPSW_NUSS=y
CONFIG_PHY=y
CONFIG_PINCTRL=y
CONFIG_SPL_PINCTRL=y
CONFIG_PINCTRL_SINGLE=y
CONFIG_POWER_DOMAIN=y
CONFIG_TI_SCI_POWER_DOMAIN=y
CONFIG_DM_REGULATOR=y
CONFIG_SPL_DM_REGULATOR=y
CONFIG_DM_REGULATOR_FIXED=y
CONFIG_SPL_DM_REGULATOR_FIXED=y
CONFIG_DM_REGULATOR_GPIO=y
CONFIG_SPL_DM_REGULATOR_GPIO=y
CONFIG_K3_SYSTEM_CONTROLLER=y
CONFIG_REMOTEPROC_TI_K3_ARM64=y
CONFIG_REMOTEPROC_TI_K3_M4F=y
CONFIG_RESET_TI_SCI=y
CONFIG_DM_SERIAL=y
CONFIG_SOC_DEVICE=y
CONFIG_SOC_DEVICE_TI_K3=y
CONFIG_SOC_TI=y
CONFIG_SYSRESET=y
CONFIG_SPL_SYSRESET=y
CONFIG_SYSRESET_TI_SCI=y
CONFIG_DM_THERMAL=y
CONFIG_FS_FAT_MAX_CLUSTSIZE=16384
CONFIG_CMD_REMOTEPROC=y
CONFIG_SPL_GZIP=y

# DFU
CONFIG_SPL_RAM_SUPPORT=y
CONFIG_SPL_RAM_DEVICE=y
CONFIG_SPL_USB_GADGET=y
CONFIG_SPL_DFU=y
CONFIG_CMD_DFU=y
CONFIG_CMD_USB=y
CONFIG_DFU_MMC=y
CONFIG_DFU_RAM=y
CONFIG_SYS_DFU_DATA_BUF_SIZE=0x40000
CONFIG_SYS_DFU_MAX_FILE_SIZE=0x800000
CONFIG_USB=y
CONFIG_DM_USB_GADGET=y
CONFIG_SPL_DM_USB_GADGET=y
CONFIG_USB_XHCI_HCD=y
CONFIG_USB_XHCI_DWC3=y
CONFIG_USB_DWC3=y
CONFIG_USB_DWC3_GENERIC=y
CONFIG_SPL_USB_DWC3_GENERIC=y
CONFIG_SPL_USB_DWC3_AM62=y
CONFIG_USB_DWC3_AM62=y
CONFIG_USB_GADGET=y
CONFIG_USB_GADGET_MANUFACTURER="Ezurio"
CONFIG_USB_GADGET_VENDOR_NUM=0x3016
CONFIG_USB_GADGET_PRODUCT_NUM=0x0001
CONFIG_USB_GADGET_DOWNLOAD=y
#

# I2C_MUX
CONFIG_I2C_MUX=y
CONFIG_I2C_MUX_PCA954x=y

# SPI
CONFIG_SPI=y
CONFIG_DM_SPI_FLASH=y
CONFIG_SPI_FLASH_WINBOND=y


# USB MSC
CONFIG_SPL_USB_HOST=y
CONFIG_SPL_USB_STORAGE=y
CONFIG_USB_HOST=y
CONFIG_USB_STORAGE=y
#

# Enable fastboot
CONFIG_USB_FUNCTION_FASTBOOT=y
CONFIG_FASTBOOT_BUF_ADDR=0xC0000000
CONFIG_FASTBOOT_BUF_SIZE=0x2F000000
CONFIG_FASTBOOT_FLASH=y
CONFIG_FASTBOOT_FLASH_MMC_DEV=0
CONFIG_CMD_GPT=y # Needed for FASTBOOT_CMD_OEM_FORMAT
CONFIG_RANDOM_UUID=y # Needed for FASTBOOT_CMD_OEM_FORMAT
CONFIG_FASTBOOT_CMD_OEM_FORMAT=y
# Enable Android boot flow
CONFIG_BOOTMETH_ANDROID=y
CONFIG_SYS_BOOTM_LEN=0x4000000
CONFIG_SYS_MALLOC_LEN=0x08000000
CONFIG_AVB_VERIFY=y
CONFIG_LIBAVB=y
CONFIG_CMD_ADTIMG=y
CONFIG_CMD_ABOOTIMG=y
CONFIG_CMD_AB_SELECT=y
CONFIG_CMD_AVB=y
# Store env in eMMC for dtbo overlays
CONFIG_DEFAULT_ENV_IS_RW=y
CONFIG_ENV_SIZE=0x2000
CONFIG_ENV_OFFSET=0xffffde00
CONFIG_ENV_IS_IN_MMC=y
CONFIG_ENV_IS_NOWHERE=n
CONFIG_SYS_MMC_ENV_PART=1
CONFIG_SPL_ENV_IS_NOWHERE=y

#include <configs/am62x_a53_splashscreen.config>
```

## configs/imx8mp_nitrogen_smarc_2gr0_defconfig
```kconfig
CONFIG_ARM=y
CONFIG_ARCH_IMX8M=y
CONFIG_TEXT_BASE=0x40200000
CONFIG_SYS_MALLOC_LEN=0x2000000
CONFIG_SPL_GPIO=y
CONFIG_SPL_LIBCOMMON_SUPPORT=y
CONFIG_SPL_LIBGENERIC_SUPPORT=y
CONFIG_NR_DRAM_BANKS=3
CONFIG_SF_DEFAULT_SPEED=40000000
CONFIG_SF_DEFAULT_MODE=0
CONFIG_ENV_SIZE=0x2000
CONFIG_ENV_OFFSET=0xffffe000
CONFIG_DM_GPIO=y
CONFIG_DEFAULT_DEVICE_TREE="imx8mp-nitrogen_smarc"
CONFIG_SPL_TEXT_BASE=0x920000
CONFIG_TARGET_IMX8MP_NITROGEN_SMARC=y
CONFIG_NITROGEN_SMARC_DEFCONFIG="imx8mp_nitrogen_smarc_2gr0"
CONFIG_OF_LIBFDT_OVERLAY=y
CONFIG_SYS_MONITOR_LEN=524288
CONFIG_SPL_SERIAL=y
CONFIG_SPL_DRIVERS_MISC=y
CONFIG_SPL_STACK=0x96dff0
CONFIG_SPL=y
CONFIG_IMX_BOOTAUX=y
CONFIG_SPL_IMX_ROMAPI_LOADADDR=0x48000000
CONFIG_SYS_LOAD_ADDR=0x40400000
CONFIG_OF_BOARD_FIXUP=y
CONFIG_SYS_MEMTEST_START=0x60000000
CONFIG_SYS_MEMTEST_END=0xC0000000
CONFIG_REMAKE_ELF=y
CONFIG_FIT=y
CONFIG_FIT_EXTERNAL_OFFSET=0x3000
CONFIG_FIT_SIGNATURE=y
CONFIG_SPL_LOAD_FIT=y
CONFIG_LEGACY_IMAGE_FORMAT=y
CONFIG_SYS_BOOTM_LEN=0x2000000
CONFIG_DISTRO_DEFAULTS=y
CONFIG_OF_BOARD_SETUP=y
CONFIG_OF_SYSTEM_SETUP=y
CONFIG_BOOTCOMMAND="run distro_bootcmd;run bsp_bootcmd"
CONFIG_DEFAULT_FDT_FILE="imx8mp-nitrogen_smarc.dtb"
CONFIG_SYS_CBSIZE=2048
CONFIG_SYS_PBSIZE=2074
CONFIG_BOARD_EARLY_INIT_F=y
CONFIG_BOARD_LATE_INIT=y
CONFIG_SPL_MAX_SIZE=0x26000
CONFIG_SPL_HAS_BSS_LINKER_SECTION=y
CONFIG_SPL_BSS_START_ADDR=0x96e000
CONFIG_SPL_BSS_MAX_SIZE=0x2000
CONFIG_SPL_BOARD_INIT=y
CONFIG_SPL_BOOTROM_SUPPORT=y
# CONFIG_SPL_SHARES_INIT_SP_ADDR is not set
CONFIG_SPL_SYS_MALLOC=y
CONFIG_SPL_HAS_CUSTOM_MALLOC_START=y
CONFIG_SPL_CUSTOM_SYS_MALLOC_ADDR=0x42200000
CONFIG_SPL_SYS_MALLOC_SIZE=0x80000
CONFIG_SYS_MMCSD_RAW_MODE_U_BOOT_USE_SECTOR=y
CONFIG_SYS_MMCSD_RAW_MODE_U_BOOT_SECTOR=0x300
CONFIG_SPL_I2C=y
CONFIG_SPL_POWER=y
CONFIG_SPL_WATCHDOG=y
CONFIG_SYS_PROMPT="u-boot=> "
# CONFIG_BOOTM_NETBSD is not set
# CONFIG_CMD_EXPORTENV is not set
CONFIG_CMD_IMPORTENV=y
CONFIG_CMD_ERASEENV=y
CONFIG_CRC32_VERIFY=y
CONFIG_CMD_MEMTEST=y
CONFIG_CMD_CLK=y
CONFIG_CMD_DFU=y
CONFIG_CMD_FUSE=y
CONFIG_CMD_GPIO=y
CONFIG_CMD_I2C=y
CONFIG_CMD_MMC=y
CONFIG_CMD_OPTEE_RPMB=y
CONFIG_CMD_POWEROFF=y
CONFIG_CMD_USB=y
CONFIG_CMD_USB_SDP=y
CONFIG_CMD_USB_MASS_STORAGE=y
CONFIG_CMD_SNTP=y
CONFIG_CMD_BMP=y
CONFIG_CMD_CACHE=y
CONFIG_CMD_RTC=y
CONFIG_CMD_TIME=y
CONFIG_CMD_GETTIME=y
CONFIG_CMD_TIMER=y
CONFIG_CMD_REGULATOR=y
CONFIG_CMD_EXT4_WRITE=y
CONFIG_OF_CONTROL=y
CONFIG_SPL_OF_CONTROL=y
CONFIG_ENV_OVERWRITE=y
CONFIG_ENV_IS_NOWHERE=y
CONFIG_ENV_IS_IN_MMC=y
CONFIG_SYS_RELOC_GD_ENV_ADDR=y
CONFIG_SYS_MMC_ENV_PART=1
CONFIG_ENV_VARS_UBOOT_RUNTIME_CONFIG=y
CONFIG_USE_ETHPRIME=y
CONFIG_ETHPRIME="eth0"
CONFIG_NET_RANDOM_ETHADDR=y
CONFIG_SPL_DM=y
CONFIG_REGMAP=y
CONFIG_SYSCON=y
CONFIG_SPL_CLK_COMPOSITE_CCF=y
CONFIG_CLK_COMPOSITE_CCF=y
CONFIG_SPL_CLK_IMX8MP=y
CONFIG_CLK_IMX8MP=y
CONFIG_DFU_TFTP=y
CONFIG_DFU_MMC=y
CONFIG_DFU_RAM=y
CONFIG_USB_FUNCTION_FASTBOOT=y
CONFIG_UDP_FUNCTION_FASTBOOT=y
CONFIG_FASTBOOT_BUF_ADDR=0x42800000
CONFIG_FASTBOOT_BUF_SIZE=0x40000000
CONFIG_FASTBOOT_FLASH=y
# CONFIG_FASTBOOT_UUU_SUPPORT is not set
CONFIG_FASTBOOT_FLASH_MMC_DEV=0
CONFIG_FASTBOOT_MMC_BOOT_SUPPORT=y
CONFIG_FASTBOOT_MMC_USER_SUPPORT=y
CONFIG_FASTBOOT_MMC_USER_NAME="emmc"
CONFIG_FASTBOOT_CMD_OEM_PARTCONF=y
CONFIG_MXC_GPIO=y
CONFIG_DM_PCA953X=y
CONFIG_DM_I2C=y
CONFIG_I2C_MUX=y
CONFIG_I2C_MUX_PCA954x=y
CONFIG_LED=y
CONFIG_LED_GPIO=y
CONFIG_SUPPORT_EMMC_RPMB=y
CONFIG_SUPPORT_EMMC_BOOT=y
CONFIG_MMC_IO_VOLTAGE=y
CONFIG_MMC_UHS_SUPPORT=y
CONFIG_MMC_HS400_ES_SUPPORT=y
CONFIG_MMC_HS400_SUPPORT=y
CONFIG_FSL_USDHC=y
CONFIG_MTD=y
CONFIG_DM_SPI_FLASH=y
CONFIG_SPI_FLASH_BAR=y
CONFIG_SPI_FLASH_STMICRO=y
CONFIG_PHY_MICREL=y
CONFIG_PHY_MICREL_KSZ90X1=y
CONFIG_DM_ETH_PHY=y
CONFIG_DWC_ETH_QOS=y
CONFIG_DWC_ETH_QOS_IMX=y
CONFIG_FEC_MXC=y
CONFIG_MII=y
CONFIG_PHY=y
CONFIG_PHY_IMX8MQ_USB=y
CONFIG_PINCTRL=y
CONFIG_SPL_PINCTRL=y
CONFIG_PINCTRL_IMX8M=y
CONFIG_POWER_DOMAIN=y
CONFIG_IMX8M_POWER_DOMAIN=y
CONFIG_IMX8M_BLK_CTRL=y
CONFIG_IMX8MP_HSIOMIX_BLKCTRL=y
CONFIG_DM_PMIC=y
CONFIG_DM_PMIC_PCA9450=y
CONFIG_SPL_DM_PMIC_PCA9450=y
CONFIG_DM_REGULATOR=y
CONFIG_DM_REGULATOR_PCA9450=y
CONFIG_DM_REGULATOR_FIXED=y
CONFIG_DM_REGULATOR_GPIO=y
CONFIG_DM_RTC=y
CONFIG_RTC_EMULATION=y
CONFIG_RTC_RV3028=y
CONFIG_DM_SERIAL=y
CONFIG_MXC_UART=y
CONFIG_SPI=y
CONFIG_DM_SPI=y
CONFIG_NXP_FSPI=y
CONFIG_SYSRESET=y
CONFIG_SYSRESET_PSCI=y
CONFIG_TEE=y
CONFIG_OPTEE=y
CONFIG_DM_THERMAL=y
CONFIG_IMX_TMU=y
CONFIG_USB=y
CONFIG_USB_XHCI_HCD=y
CONFIG_USB_XHCI_DWC3=y
CONFIG_USB_DWC3=y
CONFIG_USB_HOST_ETHER=y
CONFIG_USB_ETHER_ASIX=y
CONFIG_USB_ETHER_MCS7830=y
CONFIG_USB_ETHER_SMSC95XX=y
CONFIG_USB_GADGET=y
CONFIG_USB_GADGET_MANUFACTURER="Ezurio"
CONFIG_USB_GADGET_VENDOR_NUM=0x3016
CONFIG_USB_GADGET_PRODUCT_NUM=0x0001
CONFIG_USB_ETHER=y
CONFIG_USB_ETH_CDC=y
CONFIG_USBNET_HOST_ADDR="00:19:b8:00:00:01"
CONFIG_VIDEO=y
CONFIG_VIDEO_LOGO=y
CONFIG_SYS_WHITE_ON_BLACK=y
CONFIG_VIDEO_LCD_RAYDIUM_RM67191=y
CONFIG_VIDEO_IMX_SEC_DSI=y
CONFIG_VIDEO_IMX_LCDIFV3=y
CONFIG_SPLASH_SCREEN=y
CONFIG_SPLASH_SCREEN_ALIGN=y
CONFIG_BMP_16BPP=y
CONFIG_BMP_24BPP=y
CONFIG_BMP_32BPP=y
CONFIG_VIDEO_ADV7535=y
CONFIG_SPL_RSA=y
CONFIG_SHA384=y
CONFIG_LZO=y
CONFIG_BZIP2=y
```
