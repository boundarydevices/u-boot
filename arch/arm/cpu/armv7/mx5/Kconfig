## board/boundary/acl/Kconfig
```kconfig
if TARGET_ACL

config SYS_BOARD
	default "acl"

config SYS_VENDOR
	default "boundary"

config SYS_CONFIG_NAME
	default "acl"

source "board/boundary/common/Kconfig"

endif
```

## board/boundary/ap/Kconfig
```kconfig
if TARGET_AP

config SYS_CPU
	default "armv7"

config SYS_BOARD
	default "ap"

config SYS_VENDOR
	default "boundary"

config SYS_SOC
	default "mx6"

config SYS_CONFIG_NAME
	default "ap"

config ENV_WLMAC
	bool
	default	y

source "board/boundary/common/Kconfig"

endif
```

## board/boundary/ash/Kconfig
```kconfig
if TARGET_ASH

config SYS_CPU
	default "armv7"

config SYS_BOARD
	default "ash"

config SYS_VENDOR
	default "boundary"

config SYS_SOC
	default "mx6"

config SYS_CONFIG_NAME
	default "ash"

config BOARD_LATE_SPECIFIC_INIT
	bool
	default	y

source "board/boundary/common/Kconfig"

endif
```

## board/boundary/ash2/Kconfig
```kconfig
if TARGET_ASH2

config SYS_CPU
	default "armv7"

config SYS_BOARD
	default "ash2"

config SYS_VENDOR
	default "boundary"

config SYS_SOC
	default "mx6"

config SYS_CONFIG_NAME
	default "ash2"

config SWM_DISPLAY_00_A
	hex "switch mask(low part) for display TX23D200_18L"
	default 0

config SWM_DISPLAY_00_B
	hex "switch mask(high part) for display TX23D200_18L"
	default 0

config SWM_DISPLAY_24_A
	hex "switch mask(low part) for display AM_1280800P2TZQW"
	default 0

config SWM_DISPLAY_24_B
	hex "switch mask(high part) for display AM_1280800P2TZQW"
	default 0

source "board/boundary/common/Kconfig"

endif
```

## board/boundary/ash8mm/Kconfig
```kconfig
if TARGET_ASH8MM

config SYS_BOARD
	default "ash8mm"

config SYS_VENDOR
	default "boundary"

config SYS_CONFIG_NAME
	default "ash8mm"

config SWM_DISPLAY_00_A
	hex "switch mask(low part) for display TX23D200_18L"
	default 0

config SWM_DISPLAY_00_B
	hex "switch mask(high part) for display TX23D200_18L"
	default 0

config SWM_DISPLAY_24_A
	hex "switch mask(low part) for display AM_1280800P2TZQW"
	default 0

config SWM_DISPLAY_24_B
	hex "switch mask(high part) for display AM_1280800P2TZQW"
	default 0

config SWM_DISPLAY_38_A
	hex "switch mask(low part) for display ELHC070IK40057"
	default 0

config SWM_DISPLAY_38_B
	hex "switch mask(high part) for display ELHC070IK40057"
	default 0

source "board/boundary/common/Kconfig"

endif
```

## board/boundary/bio/Kconfig
```kconfig
if TARGET_BIO

config SYS_BOARD
	default "bio"

config SYS_VENDOR
	default "boundary"

config SYS_CONFIG_NAME
	default "bio"

source "board/boundary/common/Kconfig"

endif
```

## board/boundary/bt/Kconfig
```kconfig
if TARGET_BT

config SYS_CPU
	default "armv7"

config SYS_BOARD
	default "bt"

config SYS_VENDOR
	default "boundary"

config SYS_SOC
	default "mx6"

config SYS_CONFIG_NAME
	default "bt"

source "board/boundary/common/Kconfig"

endif
```

## board/boundary/bt2/Kconfig
```kconfig
if TARGET_BT2

config SYS_CPU
	default "armv7"

config SYS_BOARD
	default "bt2"

config SYS_VENDOR
	default "boundary"

config SYS_SOC
	default "mx6"

config SYS_CONFIG_NAME
	default "bt"

config ENV_WLMAC
	bool
	default	y

source "board/boundary/common/Kconfig"

endif
```

## board/boundary/c2-imx8mm/Kconfig
```kconfig
if TARGET_C2_IMX8MM

config SYS_BOARD
	default "c2-imx8mm"

config SYS_VENDOR
	default "boundary"

config SYS_CONFIG_NAME
	default "c2-imx8mm"

config BOARD_TYPE
	string
	default "c2"

source "board/boundary/common/Kconfig"

endif
```

## board/boundary/c2-mid/Kconfig
```kconfig
if TARGET_C2_MID

config SYS_BOARD
	default "c2-mid"

config SYS_VENDOR
	default "boundary"

config SYS_CONFIG_NAME
	default "c2-mid"

source "board/boundary/common/Kconfig"

endif
```

## board/boundary/cid/Kconfig
```kconfig
if TARGET_CID

config SYS_CPU
	default "armv7"

config SYS_BOARD
	default "cid"

config SYS_VENDOR
	default "boundary"

config SYS_SOC
	default "mx6"

config SYS_CONFIG_NAME
	default "cid"

config ENV_WLMAC
	bool
	default	y

source "board/boundary/common/Kconfig"

endif
```

## board/boundary/cle/Kconfig
```kconfig
if TARGET_CLE

config SYS_BOARD
	default "cle"

config SYS_VENDOR
	default "boundary"

config SYS_CONFIG_NAME
	default "cle"

source "board/boundary/common/Kconfig"

endif
```

## board/boundary/cnt/Kconfig
```kconfig
if TARGET_CNT

config SYS_BOARD
	default "cnt"

config SYS_VENDOR
	default "boundary"

config SYS_SOC
	default "mx6"

config SYS_CONFIG_NAME
	default "cnt"

source "board/boundary/common/Kconfig"

endif
```

## board/boundary/cob/Kconfig
```kconfig
if TARGET_COB

config SYS_CPU
	default "armv7"

config SYS_BOARD
	default "cob"

config SYS_VENDOR
	default "boundary"

config SYS_SOC
	default "mx6"

config SYS_CONFIG_NAME
	default "cob"

source "board/boundary/common/Kconfig"

endif
```

## board/boundary/crs/Kconfig
```kconfig
if TARGET_CRS

config SYS_BOARD
	default "crs"

config SYS_VENDOR
	default "boundary"

config SYS_CONFIG_NAME
	default "crs"

source "board/boundary/common/Kconfig"

endif
```
