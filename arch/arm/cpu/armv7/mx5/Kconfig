## arch/arm/cpu/armv7/mx5/Kconfig
```kconfig
if ARCH_MX5

config MX5
	bool
	default y

config MX51
	bool

config MX53
	bool

choice
	prompt "MX5 board select"
	optional

config TARGET_USBARMORY
	bool "Support USB armory"
	select CPU_V7

config TARGET_MX53CX9020
	bool "Support CX9020"
	select BOARD_LATE_INIT
	select CPU_V7
	select MX53
	select DM
	select DM_SERIAL

config TARGET_NITROGEN51_VM
	bool "Support Boundary Devices nitrogen51_vm board"
	select CPU_V7

endchoice

config SYS_SOC
	default "mx5"

source "board/beckhoff/mx53cx9020/Kconfig"
source "board/boundary/nitrogen51_vm/Kconfig"
source "board/inversepath/usbarmory/Kconfig"

endif
```

## arch/arm/cpu/armv7/mx6/Kconfig
```kconfig
if ARCH_MX6

config MX6
	bool
	default y
	select ARM_ERRATA_743622 if !MX6UL
	select ARM_ERRATA_751472 if !MX6UL
	select ARM_ERRATA_761320 if !MX6UL
	select ARM_ERRATA_794072 if !MX6UL
	imply CMD_FUSE

config MX6D
	bool

config MX6DL
	bool

config MX6Q
	bool

config MX6QDL
	bool

config MX6S
	bool

config MX6SL
	bool

config MX6SX
	select ROM_UNIFIED_SECTIONS
	bool

config MX6SLL
	select ROM_UNIFIED_SECTIONS
	bool

config MX6UL
	select SYS_L2CACHE_OFF
	select ROM_UNIFIED_SECTIONS
	bool

config MX6UL_LITESOM
	bool
	select MX6UL
	select DM
	select DM_THERMAL
	select SUPPORT_SPL

config MX6UL_OPOS6UL
	bool
	select MX6UL
	select BOARD_LATE_INIT
	select DM
	select DM_GPIO
	select DM_MMC
	select DM_THERMAL
	select SUPPORT_SPL

config MX6ULL
	bool
	select MX6UL

config MX6_DDRCAL
	bool "Include dynamic DDR calibration routines"
	depends on SPL
	default n
	help
	  Say "Y" if your board uses dynamic (per-boot) DDR calibration.
	  If unsure, say N.

choice
	prompt "MX6 board select"
	optional

config TARGET_ADVANTECH_DMS_BA16
	bool "Advantech dms-ba16"
	select BOARD_LATE_INIT
	select MX6Q

config TARGET_APALIS_IMX6
	bool "Toradex Apalis iMX6 board"
	select BOARD_LATE_INIT
	select SUPPORT_SPL
	select DM
	select DM_SERIAL
	select DM_THERMAL

config TARGET_ARISTAINETOS
	bool "aristainetos"

config TARGET_ARISTAINETOS2
	bool "aristainetos2"
	select BOARD_LATE_INIT

config TARGET_ARISTAINETOS2B
	bool "Support aristainetos2-revB"
	select BOARD_LATE_INIT

config TARGET_CGTQMX6EVAL
	bool "cgtqmx6eval"
	select BOARD_LATE_INIT
	select SUPPORT_SPL
	select DM
	select DM_THERMAL

config TARGET_CM_FX6
	bool "CM-FX6"
	select SUPPORT_SPL
	select DM
	select DM_SERIAL
	select DM_GPIO

config TARGET_COLIBRI_IMX6
	bool "Toradex Colibri iMX6 board"
	select BOARD_LATE_INIT
	select SUPPORT_SPL
	select DM
	select DM_SERIAL
	select DM_THERMAL

config TARGET_EMBESTMX6BOARDS
	bool "embestmx6boards"
	select BOARD_LATE_INIT

config TARGET_GE_B450V3
	bool "General Electric B450v3"
	select BOARD_LATE_INIT
	select MX6Q

config TARGET_GE_B650V3
	bool "General Electric B650v3"
	select BOARD_LATE_INIT
	select MX6Q

config TARGET_GE_B850V3
	bool "General Electric B850v3"
	select BOARD_LATE_INIT
	select MX6Q

config TARGET_GW_VENTANA
	bool "gw_ventana"
	select SUPPORT_SPL

config TARGET_KOSAGI_NOVENA
	bool "Kosagi Novena"
	select BOARD_LATE_INIT
	select SUPPORT_SPL

config TARGET_MCCMON6
	bool "mccmon6"
	select SUPPORT_SPL

config TARGET_MX6CUBOXI
	bool "Solid-run mx6 boards"
	select BOARD_LATE_INIT
	select SUPPORT_SPL

config TARGET_MX6LOGICPD
	bool "Logic PD i.MX6 SOM"
	select BOARD_EARLY_INIT_F
	select BOARD_LATE_INIT
	select DM
	select DM_ETH
	select DM_GPIO
	select DM_I2C
	select DM_MMC
	select DM_PMIC
	select DM_REGULATOR
	select OF_CONTROL

config TARGET_MX6QARM2
	bool "mx6qarm2"

config TARGET_MX6Q_ICORE
	bool "Support Engicam i.Core"
	select BOARD_LATE_INIT
	select MX6QDL
	select OF_CONTROL
	select SPL_OF_LIBFDT
	select DM
	select DM_ETH
	select DM_GPIO
	select DM_I2C
	select DM_MMC
	select DM_THERMAL
	select SUPPORT_SPL
	select SPL_LOAD_FIT

config TARGET_MX6Q_ICORE_RQS
	bool "Support Engicam i.Core RQS"
	select BOARD_LATE_INIT
	select MX6QDL
	select OF_CONTROL
	select SPL_OF_LIBFDT
	select DM
	select DM_ETH
	select DM_GPIO
	select DM_I2C
	select DM_MMC
	select DM_THERMAL
	select SUPPORT_SPL
	select SPL_LOAD_FIT

config TARGET_MX6QSABREAUTO
	bool "mx6qsabreauto"
	select BOARD_LATE_INIT
	select DM
	select DM_THERMAL
	select BOARD_EARLY_INIT_F

config TARGET_MX6SABRESD
	bool "mx6sabresd"
	select BOARD_LATE_INIT
	select SUPPORT_SPL
	select DM
	select DM_THERMAL
	select BOARD_EARLY_INIT_F

config TARGET_MX6SLEVK
	bool "mx6slevk"
	select SUPPORT_SPL

config TARGET_MX6SLLEVK
        bool "mx6sll evk"
	select BOARD_LATE_INIT
        select MX6SLL
        select DM
        select DM_THERMAL

config TARGET_MX6SXSABRESD
	bool "mx6sxsabresd"
	select MX6SX
	select SUPPORT_SPL
	select DM
	select DM_THERMAL
	select BOARD_EARLY_INIT_F

config TARGET_MX6SXSABREAUTO
        bool "mx6sxsabreauto"
	select BOARD_LATE_INIT
	select MX6SX
        select DM
        select DM_THERMAL
	select BOARD_EARLY_INIT_F

config TARGET_MX6UL_9X9_EVK
	bool "mx6ul_9x9_evk"
	select BOARD_LATE_INIT
	select MX6UL
	select DM
	select DM_THERMAL
	select SUPPORT_SPL

config TARGET_MX6UL_14X14_EVK
	select BOARD_LATE_INIT
	bool "mx6ul_14x14_evk"
	select MX6UL
	select DM
	select DM_THERMAL
	select SUPPORT_SPL

config TARGET_MX6UL_GEAM
	bool "Support Engicam GEAM6UL"
	select BOARD_LATE_INIT
	select MX6UL
	select OF_CONTROL
	select DM
	select DM_ETH
	select DM_GPIO
	select DM_I2C
	select DM_MMC
	select DM_THERMAL
	select SUPPORT_SPL
config TARGET_MX6UL_ISIOT
	bool "Support Engicam Is.IoT MX6UL"
	select BOARD_LATE_INIT
	select MX6UL
	select OF_CONTROL
	select DM
	select DM_ETH
	select DM_GPIO
	select DM_I2C
	select DM_MMC
	select DM_THERMAL
	select SUPPORT_SPL

config TARGET_MX6ULL_14X14_EVK
	bool "Support mx6ull_14x14_evk"
	select BOARD_LATE_INIT
	select MX6ULL
	select DM
	select DM_THERMAL

config TARGET_A
	bool "a"

config TARGET_ACL
	bool "acl"

config TARGET_ASH
	bool "ash"

config TARGET_ASH2
	bool "ash2"

config TARGET_BT
	bool "bt"

config TARGET_BT2
	bool "bt2"

config TARGET_CAD
	bool "cad"

config TARGET_CID
	bool "cid"

config TARGET_CNT
	bool "cnt"

config TARGET_COB
	bool "cob"

config TARGET_DASH
	bool "dash"

config TARGET_EO
	bool "eo"

config TARGET_H
	bool "h"

config TARGET_H4
	bool "h4"

config TARGET_HL
	bool "hl"

config TARGET_HP
	bool "hp"

config TARGET_INSP
	bool "insp"

config TARGET_IOC
	bool "ioc"

config TARGET_JLM
	bool "jlm"

config TARGET_LS
	bool "ls"

config TARGET_LSHORE
	bool "lshore"

config TARGET_MCS
	bool "mcs"

config TARGET_MED
	bool "med"

config TARGET_MTP
	bool "mtp"

config TARGET_MX6_R
	bool "mx6_r"

config TARGET_NEOL
	bool "neol"

config TARGET_NIT6XLITE
	bool "nit6xlite"

config TARGET_NITROGEN6_MAX
	bool "nitrogen6_max"

config TARGET_NITROGEN6_SCM
	bool "nitrogen6_scm"

config TARGET_NITROGEN6_SOM2
	bool "nitrogen6_som2"

config TARGET_NITROGEN6_VM
	bool "nitrogen6_vm"

config TARGET_NITROGEN6SX
	bool "nitrogen6sx"
	select MX6SX

config TARGET_NITROGEN6X
	bool "nitrogen6x"

config TARGET_OPOS6ULDEV
	bool "Armadeus OPOS6ULDev board"
	select MX6UL_OPOS6UL

config TARGET_NW
	bool "nw"

config TARGET_OC
	bool "oc"

config TARGET_PER
	bool "per"

config TARGET_RC
	bool "rc"

config TARGET_S
	bool "s"

config TARGET_SNAP
	bool "snap"

config TARGET_SP
	bool "sp"

config TARGET_TA
	bool "ta"

config TARGET_USD
	bool "usd"

config TARGET_USD_MR2
	bool "usd_mr2"

config TARGET_UTC
	bool "utc"

config TARGET_VP
	bool "vp"

config TARGET_YS
	bool "ys"
	select MX6SX

config TARGET_OT1200
	bool "Bachmann OT1200"
	select SUPPORT_SPL

config TARGET_PICO_IMX6UL
	bool "PICO-IMX6UL-EMMC"
	select MX6UL

config TARGET_LITEBOARD
	bool "Grinn liteBoard (i.MX6UL)"
	select BOARD_LATE_INIT
	select MX6UL_LITESOM

config TARGET_PLATINUM_PICON
	bool "platinum-picon"
	select SUPPORT_SPL

config TARGET_PLATINUM_TITANIUM
	bool "platinum-titanium"
	select SUPPORT_SPL

config TARGET_PCM058
	bool "Phytec PCM058 i.MX6 Quad"
	select BOARD_LATE_INIT
	select SUPPORT_SPL

config TARGET_SECOMX6
	bool "secomx6 boards"

config TARGET_TBS2910
	bool "TBS2910 Matrix ARM mini PC"

config TARGET_TITANIUM
	bool "titanium"

config TARGET_TQMA6
	bool "TQ Systems TQMa6 board"
	select BOARD_LATE_INIT

config TARGET_UDOO
	bool "udoo"
	select BOARD_LATE_INIT
	select SUPPORT_SPL

config TARGET_UDOO_NEO
	bool "UDOO Neo"
	select BOARD_LATE_INIT
	select SUPPORT_SPL
	select MX6SX
	select DM
	select DM_THERMAL

config TARGET_SAMTEC_VINING_2000
	bool "samtec VIN|ING 2000"
	select BOARD_LATE_INIT
	select MX6SX
	select DM
	select DM_THERMAL

config TARGET_WANDBOARD
	bool "wandboard"
	select BOARD_LATE_INIT
	select SUPPORT_SPL

config TARGET_WARP
	bool "WaRP"
	select BOARD_LATE_INIT

config TARGET_XPRESS
	bool "CCV xPress"
	select BOARD_LATE_INIT
	select MX6UL
	select DM
	select DM_THERMAL
	select SUPPORT_SPL

config TARGET_ZC5202
	bool "zc5202"
	select BOARD_LATE_INIT
	select SUPPORT_SPL
	select DM
	select DM_THERMAL

config TARGET_ZC5601
	bool "zc5601"
	select BOARD_LATE_INIT
	select SUPPORT_SPL
	select DM
	select DM_THERMAL

endchoice

config SYS_SOC
	default "mx6"

source "board/ge/bx50v3/Kconfig"
source "board/advantech/dms-ba16/Kconfig"
source "board/aristainetos/Kconfig"
source "board/armadeus/opos6uldev/Kconfig"
source "board/bachmann/ot1200/Kconfig"
source "board/barco/platinum/Kconfig"
source "board/barco/titanium/Kconfig"
source "board/boundary/a/Kconfig"
source "board/boundary/acl/Kconfig"
source "board/boundary/ash/Kconfig"
source "board/boundary/ash2/Kconfig"
source "board/boundary/bt/Kconfig"
source "board/boundary/bt2/Kconfig"
source "board/boundary/cad/Kconfig"
source "board/boundary/cid/Kconfig"
source "board/boundary/cnt/Kconfig"
source "board/boundary/cob/Kconfig"
source "board/boundary/dash/Kconfig"
source "board/boundary/eo/Kconfig"
source "board/boundary/h/Kconfig"
source "board/boundary/h4/Kconfig"
source "board/boundary/hl/Kconfig"
source "board/boundary/hp/Kconfig"
source "board/boundary/insp/Kconfig"
source "board/boundary/ioc/Kconfig"
source "board/boundary/jlm/Kconfig"
source "board/boundary/ls/Kconfig"
source "board/boundary/lshore/Kconfig"
source "board/boundary/mcs/Kconfig"
source "board/boundary/med/Kconfig"
source "board/boundary/mtp/Kconfig"
source "board/boundary/mx6_r/Kconfig"
source "board/boundary/neol/Kconfig"
source "board/boundary/nit6xlite/Kconfig"
source "board/boundary/nitrogen6_max/Kconfig"
source "board/boundary/nitrogen6_scm/Kconfig"
source "board/boundary/nitrogen6_som2/Kconfig"
source "board/boundary/nitrogen6_vm/Kconfig"
source "board/boundary/nitrogen6sx/Kconfig"
source "board/boundary/nitrogen6x/Kconfig"
source "board/boundary/nw/Kconfig"
source "board/boundary/oc/Kconfig"
source "board/boundary/per/Kconfig"
source "board/boundary/rc/Kconfig"
source "board/boundary/s/Kconfig"
source "board/boundary/snap/Kconfig"
source "board/boundary/sp/Kconfig"
source "board/boundary/ta/Kconfig"
source "board/boundary/usd/Kconfig"
source "board/boundary/usd_mr2/Kconfig"
source "board/boundary/utc/Kconfig"
source "board/boundary/vp/Kconfig"
source "board/boundary/ys/Kconfig"
source "board/ccv/xpress/Kconfig"
source "board/compulab/cm_fx6/Kconfig"
source "board/congatec/cgtqmx6eval/Kconfig"
source "board/el/el6x/Kconfig"
source "board/embest/mx6boards/Kconfig"
source "board/engicam/geam6ul/Kconfig"
source "board/engicam/icorem6/Kconfig"
source "board/engicam/icorem6_rqs/Kconfig"
source "board/engicam/isiotmx6ul/Kconfig"
source "board/freescale/mx6qarm2/Kconfig"
source "board/freescale/mx6qsabreauto/Kconfig"
source "board/freescale/mx6sabresd/Kconfig"
source "board/freescale/mx6slevk/Kconfig"
source "board/freescale/mx6sllevk/Kconfig"
source "board/freescale/mx6sxsabresd/Kconfig"
source "board/freescale/mx6sxsabreauto/Kconfig"
source "board/freescale/mx6ul_14x14_evk/Kconfig"
source "board/freescale/mx6ullevk/Kconfig"
source "board/grinn/liteboard/Kconfig"
source "board/phytec/pcm058/Kconfig"
source "board/gateworks/gw_ventana/Kconfig"
source "board/kosagi/novena/Kconfig"
source "board/samtec/vining_2000/Kconfig"
source "board/liebherr/mccmon6/Kconfig"
source "board/logicpd/imx6/Kconfig"
source "board/seco/Kconfig"
source "board/solidrun/mx6cuboxi/Kconfig"
source "board/technexion/pico-imx6ul/Kconfig"
source "board/tbs/tbs2910/Kconfig"
source "board/tqc/tqma6/Kconfig"
source "board/toradex/apalis_imx6/Kconfig"
source "board/toradex/colibri_imx6/Kconfig"
source "board/udoo/Kconfig"
source "board/udoo/neo/Kconfig"
source "board/wandboard/Kconfig"
source "board/warp/Kconfig"

endif
```

## arch/arm/mach-imx/imx8m/Kconfig
```kconfig
if ARCH_IMX8M

config IMX8M
	bool
	select ROM_UNIFIED_SECTIONS

config IMX8MQ
	bool
	select IMX8M

config IMX8MM
	bool "imx8mm"
	select IMX8M

config IMX8MN
	bool "imx8mn"
	select IMX8M

config IMX8MP
	bool
	select IMX8M

config SYS_SOC
	default "imx8m"

choice
	prompt	"i.MX8M board select"
	optional

config TARGET_IMX8MQ_EVK
	bool "imx8mq_evk"
	select IMX8MQ
	select IMX8M_LPDDR4

config TARGET_IMX8MQ_PHANBELL
        bool "imx8mq_phanbell"
        select IMX8MQ
        select IMX8M_LPDDR4

config TARGET_IMX8MM_EVK
	bool "imx8mm LPDDR4 EVK board"
	select IMX8MM
	select SUPPORT_SPL
	select IMX8M_LPDDR4

config TARGET_IMX8MN_EVK
	bool "imx8mn DDR4 EVK board"
	select IMX8MN
	select SUPPORT_SPL
	select IMX8M_DDR4

config TARGET_IMX8MP_EVK
	bool "imx8mp LPDDR4 EVK board"
	select IMX8MP
	select SUPPORT_SPL
	select IMX8M_LPDDR4

config TARGET_PICO_IMX8MQ
	bool "Support Technexion Pico iMX8MQ"
	select IMX8MQ
	select IMX8M_LPDDR4

config TARGET_VERDIN_IMX8MM
       bool "Support Toradex Verdin iMX8M Mini module"
       select IMX8MM
       select SUPPORT_SPL
       select IMX8M_LPDDR4

config TARGET_IMX8MM_BEACON
	bool "imx8mm Beacon Embedded devkit"
	select IMX8MM
	select SUPPORT_SPL
	select IMX8M_LPDDR4

config BOUNDARY_BOARD_IMX8M
	bool "Boundary Devices i.MX8M board"

endchoice

menu "Boundary Devices i.MX8M boards"
	depends on BOUNDARY_BOARD_IMX8M

source "board/boundary/Kconfig-imx8m"
endmenu

source "board/freescale/imx8mq_evk/Kconfig"
source "board/freescale/imx8mm_evk/Kconfig"
source "board/freescale/imx8mn_evk/Kconfig"
source "board/freescale/imx8mp_evk/Kconfig"
source "board/google/imx8mq_phanbell/Kconfig"
source "board/technexion/pico-imx8mq/Kconfig"
source "board/toradex/verdin-imx8mm/Kconfig"
source "board/beacon/imx8mm/Kconfig"

endif
```

## arch/arm/mach-imx/imx8ulp/Kconfig
```kconfig
if ARCH_IMX8ULP

config AHAB_BOOT
	bool "Support i.MX8ULP AHAB features"
	help
	  This option enables the support for AHAB secure boot.

config IMX8ULP
	select ARCH_EARLY_INIT_R
	bool

config SYS_SOC
	default "imx8ulp"

config IMX8ULP_LD_MODE
	bool
	default n

config IMX8ULP_ND_MODE
	bool "i.MX8ULP Low Driver Mode"

choice
	prompt "i.MX8ULP board select"
	optional

config TARGET_IMX8ULP_EVK
	bool "imx8ulp_evk"
	select IMX8ULP
	select SUPPORT_SPL
	select FSL_CAAM
	select FSL_BLOB
	select ARCH_MISC_INIT
	select SPL_CRYPTO if SPL

config BOUNDARY_BOARD_IMX8ULP
	bool "Boundary Devices i.MX8ULP board"

endchoice

menu "Boundary Devices i.MX8ULP boards"
	depends on BOUNDARY_BOARD_IMX8ULP

source "board/boundary/Kconfig-imx8ulp"
endmenu

source "board/freescale/imx8ulp_evk/Kconfig"

endif
```
