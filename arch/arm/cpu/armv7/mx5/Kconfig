## arch/arm/mach-imx/mx6/Kconfig
```kconfig
if ARCH_MX6

config MX6_SMP
	select ARM_ERRATA_751472
	select ARM_ERRATA_761320
	select ARM_ERRATA_794072
	select ARM_ERRATA_845369
	select MP
	bool

config MX6
	select ARM_ERRATA_743622 if !MX6UL && !MX6ULL
	select GPT_TIMER if !MX6UL && !MX6ULL
	bool
	default y
	imply CMD_FUSE

config MX6D
	select HAS_CAAM
	select MX6_SMP
	bool

config MX6DL
	select HAS_CAAM
	select MX6_SMP
	bool

config MX6Q
	select HAS_CAAM
	select MX6_SMP
	bool

config MX6QDL
	select HAS_CAAM
	select MX6_SMP
	bool

config MX6S
	select HAS_CAAM
	bool

config MX6SL
	bool

config MX6SX
	select HAS_CAAM
	select ROM_UNIFIED_SECTIONS
	bool

config MX6SLL
	select ROM_UNIFIED_SECTIONS
	bool

config MX6UL
	select HAS_CAAM
	select SYS_L2CACHE_OFF
	select ROM_UNIFIED_SECTIONS
	select SYSCOUNTER_TIMER
	bool

config MX6UL_LITESOM
	bool
	select MX6UL
	select DM
	select DM_THERMAL
	select SUPPORT_SPL

config MX6UL_OPOS6UL
	bool
	select MX6UL
	select BOARD_LATE_INIT
	select DM
	select DM_GPIO
	select DM_MMC
	select DM_THERMAL
	select SUPPORT_SPL
	select SPL_DM if SPL
	select SPL_OF_CONTROL if SPL
	select SPL_SEPARATE_BSS if SPL
	select SPL_PINCTRL if SPL

config MX6ULL
	select SYS_L2CACHE_OFF
	select ROM_UNIFIED_SECTIONS
	select SYSCOUNTER_TIMER
	bool

config MX6_DDRCAL
	bool "Include dynamic DDR calibration routines"
	depends on SPL
	default n
	help
	  Say "Y" if your board uses dynamic (per-boot) DDR calibration.
	  If unsure, say N.

config MODULE_FUSE
	bool "Enable the module disable fuse checking on i.MX6"
	default n
	select OF_SYSTEM_SETUP
	help
	  Once the module is checked as fused to disable, this module driver
	  won't be called. And it will be modified to disable in kernel DTB.

choice
	prompt "MX6 board select"
	optional

config TARGET_ADVANTECH_DMS_BA16
	bool "Advantech dms-ba16"
	select BOARD_LATE_INIT
	select MX6Q
	imply CMD_SATA

config TARGET_APALIS_IMX6
	bool "Toradex Apalis iMX6 board"
	select BOARD_LATE_INIT
	select SUPPORT_SPL
	select DM
	select DM_SERIAL
	select DM_THERMAL
	imply CMD_SATA

config TARGET_ARISTAINETOS
	bool "aristainetos"

config TARGET_ARISTAINETOS2
	bool "aristainetos2"
	select BOARD_LATE_INIT

config TARGET_ARISTAINETOS2B
	bool "Support aristainetos2-revB"
	select BOARD_LATE_INIT

config TARGET_CGTQMX6EVAL
	bool "cgtqmx6eval"
	select MX6QDL
	select BOARD_LATE_INIT
	select SUPPORT_SPL
	select DM
	select DM_THERMAL

config TARGET_CM_FX6
	bool "CM-FX6"
	select SUPPORT_SPL
	select MX6QDL
	select BOARD_LATE_INIT
	select DM
	select DM_SERIAL
	select DM_GPIO

config TARGET_COLIBRI_IMX6
	bool "Toradex Colibri iMX6 board"
	select BOARD_LATE_INIT
	select SUPPORT_SPL
	select DM
	select DM_SERIAL
	select DM_THERMAL

config TARGET_DHCOMIMX6
	bool "dh_imx6"
	select MX6QDL
	select BOARD_LATE_INIT
	select BOARD_EARLY_INIT_F
	select SUPPORT_SPL
	select DM
	select DM_THERMAL
	imply CMD_SPL

config TARGET_DISPLAY5
	bool "LWN DISPLAY5 board"
	select SUPPORT_SPL
	select DM
	select DM_SERIAL

config TARGET_EMBESTMX6BOARDS
	bool "embestmx6boards"
	select BOARD_LATE_INIT

config TARGET_GE_BX50V3
	bool "General Electric Bx50v3"
	select BOARD_LATE_INIT
	select MX6Q

config TARGET_GW_VENTANA
	bool "gw_ventana"
	select MX6QDL
	select SUPPORT_SPL
	imply CMD_SATA
	imply CMD_SPL

config TARGET_KOSAGI_NOVENA
	bool "Kosagi Novena"
	select BOARD_LATE_INIT
	select SUPPORT_SPL

config TARGET_MCCMON6
	bool "mccmon6"
	select MX6QDL
	select SUPPORT_SPL

config TARGET_MX6CUBOXI
	bool "Solid-run mx6 boards"
	select MX6QDL
	select BOARD_LATE_INIT
	select SUPPORT_SPL

config TARGET_MX6LOGICPD
	bool "Logic PD i.MX6 SOM"
	select BOARD_EARLY_INIT_F
	select BOARD_LATE_INIT
	select DM
	select DM_ETH
	select DM_GPIO
	select DM_I2C
	select DM_MMC
	select DM_PMIC
	select DM_REGULATOR
	select OF_CONTROL

config TARGET_MX6MEMCAL
	bool "mx6memcal"
	select SUPPORT_SPL
	help
	  The mx6memcal board is a virtual board that can be used to validate
	  and characterize the memory layout of a new design during the initial
	  development and pre-production stages.

config TARGET_MX6QARM2
	bool "mx6qarm2"

config TARGET_MX6DL_MAMOJ
	bool "Support BTicino Mamoj"
	select MX6QDL
	select OF_CONTROL
	select PINCTRL
	select DM
	select DM_ETH
	select DM_GPIO
	select DM_I2C
	select DM_MMC
	select DM_PMIC
	select DM_PMIC_PFUZE100
	select DM_THERMAL
	select SPL
	select SUPPORT_SPL
	select SPL_DM if SPL
	select SPL_OF_LIBFDT if SPL
	select SPL_OF_CONTROL if SPL
	select SPL_PINCTRL if SPL
	select SPL_SEPARATE_BSS if SPL
	select SPL_GPIO_SUPPORT if SPL
	select SPL_LIBCOMMON_SUPPORT if SPL
	select SPL_LIBDISK_SUPPORT if SPL
	select SPL_LIBGENERIC_SUPPORT if SPL
	select SPL_MMC_SUPPORT if SPL
	select SPL_SERIAL_SUPPORT if SPL
	select SPL_USB_HOST_SUPPORT if SPL
	select SPL_USB_GADGET_SUPPORT if SPL
	select SPL_USB_SDP_SUPPORT if SPL
	select SPL_WATCHDOG_SUPPORT if SPL

config TARGET_MX6Q_ENGICAM
	bool "Support Engicam i.Core(RQS)"
	select BOARD_LATE_INIT
	select MX6QDL
	select OF_CONTROL
	select SPL_OF_LIBFDT
	select DM
	select DM_ETH
	select DM_GPIO
	select DM_I2C
	select DM_MMC
	select DM_THERMAL
	select SUPPORT_SPL
	select SPL_DM if SPL
	select SPL_OF_CONTROL if SPL
	select SPL_SEPARATE_BSS if SPL
	select SPL_PINCTRL if SPL

config TARGET_MX6SABREAUTO
	bool "mx6sabreauto"
	select MX6QDL
	select BOARD_LATE_INIT
	select SUPPORT_SPL
	select DM
	select DM_THERMAL
	select BOARD_EARLY_INIT_F

config TARGET_MX6SABRESD
	bool "mx6sabresd"
	select MX6QDL
	select BOARD_LATE_INIT
	select SUPPORT_SPL
	select DM
	select DM_THERMAL
	select BOARD_EARLY_INIT_F

config TARGET_MX6SLEVK
	bool "mx6slevk"
	select MX6SL
	select SUPPORT_SPL

config TARGET_MX6SLLEVK
        bool "mx6sll evk"
	select BOARD_LATE_INIT
        select MX6SLL
        select DM
        select DM_THERMAL

config TARGET_MX6SXSABRESD
	bool "mx6sxsabresd"
	select BOARD_LATE_INIT
	select MX6SX
	select SUPPORT_SPL
	select DM
	select DM_THERMAL
	select BOARD_EARLY_INIT_F

config TARGET_MX6SXSABREAUTO
        bool "mx6sxsabreauto"
	select BOARD_LATE_INIT
	select MX6SX
        select DM
        select DM_THERMAL
	select BOARD_EARLY_INIT_F

config TARGET_MX6UL_9X9_EVK
	bool "mx6ul_9x9_evk"
	select BOARD_LATE_INIT
	select MX6UL
	select DM
	select DM_THERMAL
	select SUPPORT_SPL

config TARGET_MX6UL_14X14_EVK
	select BOARD_LATE_INIT
	bool "mx6ul_14x14_evk"
	select MX6UL
	select DM
	select DM_THERMAL
	select SUPPORT_SPL

config TARGET_MX6UL_ENGICAM
	bool "Support Engicam GEAM6UL/Is.IoT"
	select BOARD_LATE_INIT
	select MX6UL
	select OF_CONTROL
	select DM
	select DM_ETH
	select DM_GPIO
	select DM_I2C
	select DM_MMC
	select DM_THERMAL
	select SUPPORT_SPL
	select SPL_DM if SPL
	select SPL_OF_CONTROL if SPL
	select SPL_SEPARATE_BSS if SPL
	select SPL_PINCTRL if SPL

config TARGET_MX6ULL_14X14_EVK
	bool "Support mx6ull_14x14_evk"
	select BOARD_LATE_INIT
	select MX6ULL
	select DM
	select DM_THERMAL

config TARGET_A
	bool "a"

config TARGET_ACL
	bool "acl"

config TARGET_AP
	bool "ap"

config TARGET_ASH
	bool "ash"

config TARGET_ASH2
	bool "ash2"

config TARGET_BT
	bool "bt"

config TARGET_BT2
	bool "bt2"

config TARGET_CAD
	bool "cad"

config TARGET_CID
	bool "cid"

config TARGET_CID_TAB
	bool "cid_tab"

config TARGET_CNT
	bool "cnt"

config TARGET_COB
	bool "cob"

config TARGET_COB2
	bool "cob2"

config TARGET_DASH
	bool "dash"

config TARGET_EO
	bool "eo"

config TARGET_H
	bool "h"

config TARGET_H4
	bool "h4"

config TARGET_HL
	bool "hl"

config TARGET_HP
	bool "hp"

config TARGET_INSP
	bool "insp"

config TARGET_IOC
	bool "ioc"

config TARGET_JLM
	bool "jlm"

config TARGET_LS
	bool "ls"

config TARGET_LSHORE
	bool "lshore"

config TARGET_LTCH
	bool "ltch"

config TARGET_MCS
	bool "mcs"

config TARGET_MED
	bool "med"

config TARGET_MTP
	bool "mtp"

config TARGET_MX6_R
	bool "mx6_r"

config TARGET_NEOL
	bool "neol"

config TARGET_NIT6XLITE
	bool "nit6xlite"

config TARGET_NITROGEN6_MAX
	bool "nitrogen6_max"

config TARGET_NITROGEN6_SCM
	bool "nitrogen6_scm"

config TARGET_NITROGEN6_SOM2
	bool "nitrogen6_som2"

config TARGET_NITROGEN6_VM
	bool "nitrogen6_vm"

config TARGET_NITROGEN6SX
	bool "nitrogen6sx"
	select MX6SX

config TARGET_NITROGEN6X
	bool "nitrogen6x"
	imply USB_HOST_ETHER
	imply USB_ETHER_ASIX
	imply USB_ETHER_SMSC95XX
	imply USB_ETHER_MCS7830

config TARGET_OPOS6ULDEV
	bool "Armadeus OPOS6ULDev board"
	select MX6UL_OPOS6UL

config TARGET_NW
	bool "nw"

config TARGET_OC
	bool "oc"

config TARGET_PER
	bool "per"

config TARGET_RC
	bool "rc"

config TARGET_S
	bool "s"

config TARGET_SES
	bool "ses"

config TARGET_SNAP
	bool "snap"

config TARGET_SP
	bool "sp"

config TARGET_TA
	bool "ta"

config TARGET_USD
	bool "usd"

config TARGET_USD_MR2
	bool "usd_mr2"

config TARGET_UTC
	bool "utc"

config TARGET_VP
	bool "vp"

config TARGET_YS
	bool "ys"
	select MX6SX

config TARGET_OT1200
	bool "Bachmann OT1200"
	select SUPPORT_SPL
	imply CMD_SATA

config TARGET_PICO_IMX6UL
	bool "PICO-IMX6UL-EMMC"
	select MX6UL

config TARGET_LITEBOARD
	bool "Grinn liteBoard (i.MX6UL)"
	select BOARD_LATE_INIT
	select MX6UL_LITESOM

config TARGET_PLATINUM_PICON
	bool "platinum-picon"
	select SUPPORT_SPL

config TARGET_PLATINUM_TITANIUM
	bool "platinum-titanium"
	select SUPPORT_SPL

config TARGET_PCM058
	bool "Phytec PCM058 i.MX6 Quad"
	select BOARD_LATE_INIT
	select SUPPORT_SPL

config TARGET_PFLA02
	bool "Phytec PFLA02 (PhyFlex) i.MX6 Quad"
	select MX6QDL
	select BOARD_LATE_INIT
	select SUPPORT_SPL

config TARGET_SECOMX6
	bool "secomx6 boards"

config TARGET_SKSIMX6
	bool "sks-imx6"
	select SUPPORT_SPL

config TARGET_TBS2910
	bool "TBS2910 Matrix ARM mini PC"

config TARGET_TITANIUM
	bool "titanium"

config TARGET_KP_IMX6Q_TPC
	bool "K+P KP_IMX6Q_TPC i.MX6 Quad"
	select MX6QDL
	select BOARD_LATE_INIT
	select BOARD_EARLY_INIT_F
	select SUPPORT_SPL
	select DM
	select DM_THERMAL
	imply CMD_SPL

config TARGET_TQMA6
	bool "TQ Systems TQMa6 board"
	select BOARD_LATE_INIT

config TARGET_UDOO
	bool "udoo"
	select MX6QDL
	select BOARD_LATE_INIT
	select SUPPORT_SPL

config TARGET_UDOO_NEO
	bool "UDOO Neo"
	select BOARD_LATE_INIT
	select SUPPORT_SPL
	select MX6SX
	select DM
	select DM_THERMAL

config TARGET_SAMTEC_VINING_2000
	bool "samtec VIN|ING 2000"
	select BOARD_LATE_INIT
	select MX6SX
	select DM
	select DM_THERMAL

config TARGET_WANDBOARD
	bool "wandboard"
	select MX6QDL
	select BOARD_LATE_INIT
	select SUPPORT_SPL

config TARGET_WARP
	bool "WaRP"
	select MX6SL
	select BOARD_LATE_INIT

config TARGET_XPRESS
	bool "CCV xPress"
	select BOARD_LATE_INIT
	select MX6UL
	select DM
	select DM_THERMAL
	select SUPPORT_SPL

config TARGET_ZC5202
	bool "zc5202"
	select BOARD_LATE_INIT
	select SUPPORT_SPL
	select DM
	select DM_THERMAL

config TARGET_ZC5601
	bool "zc5601"
	select BOARD_LATE_INIT
	select SUPPORT_SPL
	select DM
	select DM_THERMAL

endchoice

config SYS_SOC
	default "mx6"

source "board/ge/bx50v3/Kconfig"
source "board/advantech/dms-ba16/Kconfig"
source "board/aristainetos/Kconfig"
source "board/armadeus/opos6uldev/Kconfig"
source "board/bachmann/ot1200/Kconfig"
source "board/barco/platinum/Kconfig"
source "board/barco/titanium/Kconfig"
source "board/boundary/a/Kconfig"
source "board/boundary/acl/Kconfig"
source "board/boundary/ap/Kconfig"
source "board/boundary/ash/Kconfig"
source "board/boundary/ash2/Kconfig"
source "board/boundary/bt/Kconfig"
source "board/boundary/bt2/Kconfig"
source "board/boundary/cad/Kconfig"
source "board/boundary/cid/Kconfig"
source "board/boundary/cid_tab/Kconfig"
source "board/boundary/cnt/Kconfig"
source "board/boundary/cob/Kconfig"
source "board/boundary/cob2/Kconfig"
source "board/boundary/dash/Kconfig"
source "board/boundary/eo/Kconfig"
source "board/boundary/h/Kconfig"
source "board/boundary/h4/Kconfig"
source "board/boundary/hl/Kconfig"
source "board/boundary/hp/Kconfig"
source "board/boundary/insp/Kconfig"
source "board/boundary/ioc/Kconfig"
source "board/boundary/jlm/Kconfig"
source "board/boundary/ls/Kconfig"
source "board/boundary/lshore/Kconfig"
source "board/boundary/ltch/Kconfig"
source "board/boundary/mcs/Kconfig"
source "board/boundary/med/Kconfig"
source "board/boundary/mtp/Kconfig"
source "board/boundary/mx6_r/Kconfig"
source "board/boundary/neol/Kconfig"
source "board/boundary/nit6xlite/Kconfig"
source "board/boundary/nitrogen6_max/Kconfig"
source "board/boundary/nitrogen6_scm/Kconfig"
source "board/boundary/nitrogen6_som2/Kconfig"
source "board/boundary/nitrogen6_vm/Kconfig"
source "board/boundary/nitrogen6sx/Kconfig"
source "board/boundary/nitrogen6x/Kconfig"
source "board/boundary/nw/Kconfig"
source "board/boundary/oc/Kconfig"
source "board/boundary/per/Kconfig"
source "board/boundary/rc/Kconfig"
source "board/boundary/s/Kconfig"
source "board/boundary/ses/Kconfig"
source "board/boundary/snap/Kconfig"
source "board/boundary/sp/Kconfig"
source "board/boundary/ta/Kconfig"
source "board/boundary/usd/Kconfig"
source "board/boundary/usd_mr2/Kconfig"
source "board/boundary/utc/Kconfig"
source "board/boundary/vp/Kconfig"
source "board/boundary/ys/Kconfig"
source "board/bticino/mamoj/Kconfig"
source "board/ccv/xpress/Kconfig"
source "board/compulab/cm_fx6/Kconfig"
source "board/congatec/cgtqmx6eval/Kconfig"
source "board/dhelectronics/dh_imx6/Kconfig"
source "board/el/el6x/Kconfig"
source "board/embest/mx6boards/Kconfig"
source "board/engicam/imx6q/Kconfig"
source "board/engicam/imx6ul/Kconfig"
source "board/freescale/mx6qarm2/Kconfig"
source "board/freescale/mx6memcal/Kconfig"
source "board/freescale/mx6sabreauto/Kconfig"
source "board/freescale/mx6sabresd/Kconfig"
source "board/freescale/mx6slevk/Kconfig"
source "board/freescale/mx6sllevk/Kconfig"
source "board/freescale/mx6sxsabresd/Kconfig"
source "board/freescale/mx6sxsabreauto/Kconfig"
source "board/freescale/mx6ul_14x14_evk/Kconfig"
source "board/freescale/mx6ullevk/Kconfig"
source "board/grinn/liteboard/Kconfig"
source "board/phytec/pcm058/Kconfig"
source "board/phytec/pfla02/Kconfig"
source "board/gateworks/gw_ventana/Kconfig"
source "board/kosagi/novena/Kconfig"
source "board/samtec/vining_2000/Kconfig"
source "board/liebherr/display5/Kconfig"
source "board/liebherr/mccmon6/Kconfig"
source "board/logicpd/imx6/Kconfig"
source "board/seco/Kconfig"
source "board/sks-kinkel/sksimx6/Kconfig"
source "board/solidrun/mx6cuboxi/Kconfig"
source "board/technexion/pico-imx6ul/Kconfig"
source "board/tbs/tbs2910/Kconfig"
source "board/tqc/tqma6/Kconfig"
source "board/toradex/apalis_imx6/Kconfig"
source "board/toradex/colibri_imx6/Kconfig"
source "board/k+p/kp_imx6q_tpc/Kconfig"
source "board/udoo/Kconfig"
source "board/udoo/neo/Kconfig"
source "board/wandboard/Kconfig"
source "board/warp/Kconfig"

endif
```

## arch/arm/mach-imx/mx8m/Kconfig
```kconfig
if ARCH_IMX8M

config IMX8M
	bool
	select ROM_UNIFIED_SECTIONS

choice
	prompt	"NXP i.MX8M board select"
	optional

config TARGET_NITROGEN8M
	bool "nitrogen8m"
	select IMX8M
	select SUPPORT_SPL

endchoice

config SYS_SOC
	default "mx8m"

source "board/boundary/nitrogen8m/Kconfig"
endif
```

## arch/arm/mach-mediatek/mt8195/Kconfig
```kconfig
if TARGET_MT8195

config SYS_BOARD
	default "mt8195"

config SYS_CONFIG_NAME
	default "mt8195"

config MTK_BROM_HEADER_INFO
	string
	default "media=emmc"

endif
```

## board/amlogic/defconfigs/g12b_w200_v1_defconfig
```kconfig
CONFIG_ARM=y
CONFIG_TARGET_MESON_G12B=y
CONFIG_G12B_W200_V1=y
CONFIG_DM=y
CONFIG_DM_GPIO=y
CONFIG_AML_GPIO=y
```

## board/boundary/a/Kconfig
```kconfig
if TARGET_A

config SYS_CPU
	default "armv7"

config SYS_BOARD
	default "a"

config SYS_VENDOR
	default "boundary"

config SYS_SOC
	default "mx6"

config SYS_CONFIG_NAME
	default "a"

source "board/boundary/common/Kconfig"

endif
```

## board/boundary/a2/Kconfig
```kconfig
if TARGET_A2

config SYS_CPU
	default "armv7"

config SYS_BOARD
	default "a2"

config SYS_VENDOR
	default "boundary"

config SYS_SOC
	default "mx6"

config SYS_CONFIG_NAME
	default "a2"

source "board/boundary/common/Kconfig"

endif
```
