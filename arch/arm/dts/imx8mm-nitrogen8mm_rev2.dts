/*
 * Copyright 2018 NXP
 *
 * This program is free software; you can redistribute it and/or
 * modify it under the terms of the GNU General Public License
 * as published by the Free Software Foundation; either version 2
 * of the License, or (at your option) any later version.
 *
 * This program is distributed in the hope that it will be useful,
 * but WITHOUT ANY WARRANTY; without even the implied warranty of
 * MERCHANTABILITY or FITNESS FOR A PARTICULAR PURPOSE.  See the
 * GNU General Public License for more details.
 */

#include "imx8mm-nitrogen8mm.dts"

/ {
	model = "Boundary Devices i.MX8MMini Nitrogen8MM Rev2";
	compatible = "boundary,imx8mm-nitrogen8mm_rev2", "fsl,imx8mm";
};

&wdog1 {
	/delete-property/ reset-gpios;
};
