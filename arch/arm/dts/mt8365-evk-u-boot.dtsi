// SPDX-License-Identifier: (GPL-2.0 OR MIT)
/*
 * Copyright (c) 2024 Baylibre SAS.
 * Author: Julien Masson <jmasson@baylibre.com>
 */

#include "mt8365-u-boot.dtsi"

&usb {
	status = "okay";
};

&ssusb {
	mediatek,force-vbus;
	maximum-speed = "high-speed";
	dr_mode = "peripheral";
	status = "okay";
};
