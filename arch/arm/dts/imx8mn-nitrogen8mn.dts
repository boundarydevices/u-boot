/*
 * Copyright 2018 NXP
 *
 * This program is free software; you can redistribute it and/or
 * modify it under the terms of the GNU General Public License
 * as published by the Free Software Foundation; either version 2
 * of the License, or (at your option) any later version.
 *
 * This program is distributed in the hope that it will be useful,
 * but WITHOUT ANY WARRANTY; without even the implied warranty of
 * MERCHANTABILITY or FITNESS FOR A PARTICULAR PURPOSE.  See the
 * GNU General Public License for more details.
 */

/dts-v1/;
#define MX8MMN(a,b)	MX8MN_##a b
#define IMX8MMN(a)	IMX8MN_##a
#include "imx8mn.dtsi"
#include "imx8mmn-nitrogen8mm.dtsi"

/ {
	model = "Boundary Devices i.MX8M Nano Nitrogen8MN";
	compatible = "boundary,imx8mn-nitrogen8mn", "fsl,imx8mn";
};
