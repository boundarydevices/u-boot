// SPDX-License-Identifier: GPL-2.0+
/*
 * Copyright (C) 2022 Boundary Devices
 */

#include "imx6qdl-u-boot.dtsi"

&usdhc3 {
	u-boot,dm-spl;
};

&usdhc4 {
	u-boot,dm-spl;
};

&pinctrl_usdhc3 {
	u-boot,dm-spl;
};

&pinctrl_usdhc4 {
	u-boot,dm-spl;
};
